/dts-v1/;

/ {

	fragment@0 {
		target = <0xffffffff>;

		__overlay__ {

			cam0@0 {
				phandle = <0x02>;

				pins_cmd_dat {
					pinmux = <0x1200>;
					slew-rate = <0x01>;
					output-low;
				};
			};

			cam0@1 {
				phandle = <0x03>;

				pins_cmd_dat {
					pinmux = <0x1200>;
					slew-rate = <0x01>;
					output-high;
				};
			};

			cam1@0 {
				phandle = <0x04>;

				pins_cmd_dat {
					pinmux = <0x1000>;
					slew-rate = <0x01>;
					output-low;
				};
			};

			cam1@1 {
				phandle = <0x05>;

				pins_cmd_dat {
					pinmux = <0x1000>;
					slew-rate = <0x01>;
					output-high;
				};
			};

			cam2@0 {
				phandle = <0x06>;

				pins_cmd_dat {
					pinmux = <0x1600>;
					slew-rate = <0x01>;
					output-low;
				};
			};

			cam2@1 {
				phandle = <0x07>;

				pins_cmd_dat {
					pinmux = <0x1600>;
					slew-rate = <0x01>;
					output-high;
				};
			};

			cam3@0 {
				phandle = <0x08>;

				pins_cmd_dat {
					pinmux = <0x1400>;
					slew-rate = <0x01>;
					output-low;
				};
			};

			cam3@1 {
				phandle = <0x09>;

				pins_cmd_dat {
					pinmux = <0x1400>;
					slew-rate = <0x01>;
					output-high;
				};
			};

			cam0@2 {
				phandle = <0x0a>;

				pins_cmd_dat {
					pinmux = <0xa00>;
					slew-rate = <0x01>;
					output-low;
				};
			};

			cam0@3 {
				phandle = <0x0b>;

				pins_cmd_dat {
					pinmux = <0xa00>;
					slew-rate = <0x01>;
					output-high;
				};
			};

			cam1@2 {
				phandle = <0x0c>;

				pins_cmd_dat {
					pinmux = <0xa00>;
					slew-rate = <0x01>;
					output-low;
				};
			};

			cam1@3 {
				phandle = <0x0d>;

				pins_cmd_dat {
					pinmux = <0xa00>;
					slew-rate = <0x01>;
					output-high;
				};
			};

			cam2@2 {
				phandle = <0x0e>;

				pins_cmd_dat {
					pinmux = <0xa00>;
					slew-rate = <0x01>;
					output-low;
				};
			};

			cam2@3 {
				phandle = <0x0f>;

				pins_cmd_dat {
					pinmux = <0xa00>;
					slew-rate = <0x01>;
					output-high;
				};
			};

			cam3@2 {
				phandle = <0x10>;

				pins_cmd_dat {
					pinmux = <0xa00>;
					slew-rate = <0x01>;
					output-low;
				};
			};

			cam3@3 {
				phandle = <0x11>;

				pins_cmd_dat {
					pinmux = <0xa00>;
					slew-rate = <0x01>;
					output-high;
				};
			};

			camera_pins_cam0_mclk_off {
				phandle = <0x12>;

				pins_cmd_dat {
					pinmux = <0x7f00>;
					drive-strength = <0x01>;
				};
			};

			camera_pins_cam0_mclk_2ma {
				phandle = <0x13>;

				pins_cmd_dat {
					pinmux = <0x7f01>;
					drive-strength = <0x00>;
				};
			};

			camera_pins_cam0_mclk_4ma {
				phandle = <0x14>;

				pins_cmd_dat {
					pinmux = <0x7f01>;
					drive-strength = <0x01>;
				};
			};

			camera_pins_cam0_mclk_6ma {
				phandle = <0x15>;

				pins_cmd_dat {
					pinmux = <0x7f01>;
					drive-strength = <0x02>;
				};
			};

			camera_pins_cam0_mclk_8ma {
				phandle = <0x16>;

				pins_cmd_dat {
					pinmux = <0x7f01>;
					drive-strength = <0x03>;
				};
			};

			camera_pins_cam1_mclk_off {
				phandle = <0x17>;

				pins_cmd_dat {
					pinmux = <0x7e00>;
					drive-strength = <0x01>;
				};
			};

			camera_pins_cam1_mclk_2ma {
				phandle = <0x18>;

				pins_cmd_dat {
					pinmux = <0x7e01>;
					drive-strength = <0x00>;
				};
			};

			camera_pins_cam1_mclk_4ma {
				phandle = <0x19>;

				pins_cmd_dat {
					pinmux = <0x7e01>;
					drive-strength = <0x01>;
				};
			};

			camera_pins_cam1_mclk_6ma {
				phandle = <0x1a>;

				pins_cmd_dat {
					pinmux = <0x7e01>;
					drive-strength = <0x02>;
				};
			};

			camera_pins_cam1_mclk_8ma {
				phandle = <0x1b>;

				pins_cmd_dat {
					pinmux = <0x7e01>;
					drive-strength = <0x03>;
				};
			};

			camera_pins_cam2_mclk_off {
				phandle = <0x1c>;

				pins_cmd_dat {
					pinmux = <0x8100>;
					drive-strength = <0x01>;
				};
			};

			camera_pins_cam2_mclk_2ma {
				phandle = <0x1d>;

				pins_cmd_dat {
					pinmux = <0x8101>;
					drive-strength = <0x00>;
				};
			};

			camera_pins_cam2_mclk_4ma {
				phandle = <0x1e>;

				pins_cmd_dat {
					pinmux = <0x8101>;
					drive-strength = <0x01>;
				};
			};

			camera_pins_cam2_mclk_6ma {
				phandle = <0x1f>;

				pins_cmd_dat {
					pinmux = <0x8101>;
					drive-strength = <0x02>;
				};
			};

			camera_pins_cam2_mclk_8ma {
				phandle = <0x20>;

				pins_cmd_dat {
					pinmux = <0x8101>;
					drive-strength = <0x03>;
				};
			};

			camera_pins_cam3_mclk_off {
				phandle = <0x21>;

				pins_cmd_dat {
					pinmux = <0x8000>;
					drive-strength = <0x01>;
				};
			};

			camera_pins_cam3_mclk_2ma {
				phandle = <0x22>;

				pins_cmd_dat {
					pinmux = <0x8001>;
					drive-strength = <0x00>;
				};
			};

			camera_pins_cam3_mclk_4ma {
				phandle = <0x23>;

				pins_cmd_dat {
					pinmux = <0x8001>;
					drive-strength = <0x01>;
				};
			};

			camera_pins_cam3_mclk_6ma {
				phandle = <0x24>;

				pins_cmd_dat {
					pinmux = <0x8001>;
					drive-strength = <0x02>;
				};
			};

			camera_pins_cam3_mclk_8ma {
				phandle = <0x25>;

				pins_cmd_dat {
					pinmux = <0x8001>;
					drive-strength = <0x03>;
				};
			};

			camdefault {
				phandle = <0x01>;
			};
		};
	};

	fragment@1 {
		target = <0xffffffff>;

		__overlay__ {
			pinctrl-names = "default\0cam0_rst0\0cam0_rst1\0cam1_rst0\0cam1_rst1\0cam2_rst0\0cam2_rst1\0cam3_rst0\0cam3_rst1\0cam0_ldo_vcamio_0\0cam0_ldo_vcamio_1\0cam1_ldo_vcamio_0\0cam1_ldo_vcamio_1\0cam2_ldo_vcamio_0\0cam2_ldo_vcamio_1\0cam3_ldo_vcamio_0\0cam3_ldo_vcamio_1\0cam0_mclk_off\0cam0_mclk_2mA\0cam0_mclk_4mA\0cam0_mclk_6mA\0cam0_mclk_8mA\0cam1_mclk_off\0cam1_mclk_2mA\0cam1_mclk_4mA\0cam1_mclk_6mA\0cam1_mclk_8mA\0cam2_mclk_off\0cam2_mclk_2mA\0cam2_mclk_4mA\0cam2_mclk_6mA\0cam2_mclk_8mA\0cam3_mclk_off\0cam3_mclk_2mA\0cam3_mclk_4mA\0cam3_mclk_6mA\0cam3_mclk_8mA";
			pinctrl-0 = <0x01>;
			pinctrl-1 = <0x02>;
			pinctrl-2 = <0x03>;
			pinctrl-3 = <0x04>;
			pinctrl-4 = <0x05>;
			pinctrl-5 = <0x06>;
			pinctrl-6 = <0x07>;
			pinctrl-7 = <0x08>;
			pinctrl-8 = <0x09>;
			pinctrl-9 = <0x0a>;
			pinctrl-10 = <0x0b>;
			pinctrl-11 = <0x0c>;
			pinctrl-12 = <0x0d>;
			pinctrl-13 = <0x0e>;
			pinctrl-14 = <0x0f>;
			pinctrl-15 = <0x10>;
			pinctrl-16 = <0x11>;
			pinctrl-17 = <0x12>;
			pinctrl-18 = <0x13>;
			pinctrl-19 = <0x14>;
			pinctrl-20 = <0x15>;
			pinctrl-21 = <0x16>;
			pinctrl-22 = <0x17>;
			pinctrl-23 = <0x18>;
			pinctrl-24 = <0x19>;
			pinctrl-25 = <0x1a>;
			pinctrl-26 = <0x1b>;
			pinctrl-27 = <0x1c>;
			pinctrl-28 = <0x1d>;
			pinctrl-29 = <0x1e>;
			pinctrl-30 = <0x1f>;
			pinctrl-31 = <0x20>;
			pinctrl-32 = <0x21>;
			pinctrl-33 = <0x22>;
			pinctrl-34 = <0x23>;
			pinctrl-35 = <0x24>;
			pinctrl-36 = <0x25>;
			status = "okay";
			cam0_enable_sensor = "s5kjn1_sunny_main_mipi_raw s5kjn1_ofilm_main_mipi_raw";
			cam1_enable_sensor = "ov8856_aac_front_mipi_raw ov8856_ofilm_front_mipi_raw gc5035_sunny_front_mipi_raw hi556_ofilm_front_mipi_raw";
			cam2_enable_sensor = "ov02b1b_sunny_depth_mipi_raw sc202cs_ofilm_depth_mipi_raw";
			cam3_enable_sensor = "gc02m1_ofilm_macro_mipi_raw gc02m1_aac_macro_mipi_raw";
		};
	};

	fragment@2 {
		target = <0xffffffff>;

		__overlay__ {
			camaf_m1_pmic-supply = <0xffffffff>;
		};
	};

	fragment@3 {
		target = <0xffffffff>;

		__overlay__ {
			status = "okay";
			clock-frequency = <0x61a80>;
			#address-cells = <0x01>;
			#size-cells = <0x00>;

			camera_eeprom3@51 {
				compatible = "mediatek,camera_eeprom";
				reg = <0x51>;
				status = "okay";
				phandle = <0x48>;
			};

			camera_sub_two@10 {
				compatible = "mediatek,camera_sub_two";
				#thermal-sensor-cells = <0x00>;
				reg = <0x10>;
				status = "okay";
				phandle = <0x49>;
			};
		};
	};

	fragment@4 {
		target = <0xffffffff>;

		__overlay__ {
			status = "okay";
			clock-frequency = <0x61a80>;
			#address-cells = <0x01>;
			#size-cells = <0x00>;

			camera_eeprom1@51 {
				compatible = "mediatek,camera_eeprom";
				reg = <0x51>;
				status = "okay";
				phandle = <0x4a>;
			};

			camera_sub@1a {
				compatible = "mediatek,camera_sub";
				#thermal-sensor-cells = <0x00>;
				reg = <0x1a>;
				status = "okay";
				phandle = <0x4b>;
			};
		};
	};

	fragment@5 {
		target = <0xffffffff>;

		__overlay__ {
			status = "okay";
			clock-frequency = <0x61a80>;
			#address-cells = <0x01>;
			#size-cells = <0x00>;

			camera_eeprom0@50 {
				compatible = "mediatek,camera_eeprom";
				reg = <0x50>;
				status = "okay";
				phandle = <0x4c>;
			};

			camera_main@1a {
				compatible = "mediatek,camera_main";
				#thermal-sensor-cells = <0x00>;
				reg = <0x1a>;
				status = "okay";
				phandle = <0x4d>;
			};

			camera_main_af@18 {
				compatible = "mediatek,camera_main_af";
				reg = <0x18>;
				status = "okay";
				phandle = <0x4e>;
			};
		};
	};

	fragment@6 {
		target = <0xffffffff>;

		__overlay__ {
			status = "okay";
			clock-frequency = <0x61a80>;
			#address-cells = <0x01>;
			#size-cells = <0x00>;

			camera_eeprom2@51 {
				compatible = "mediatek,camera_eeprom";
				reg = <0x51>;
				status = "okay";
				phandle = <0x4f>;
			};

			camera_main_two@10 {
				compatible = "mediatek,camera_main_two";
				#thermal-sensor-cells = <0x00>;
				reg = <0x10>;
				status = "okay";
				phandle = <0x50>;
			};
		};
	};

	fragment@7 {
		target = <0xffffffff>;

		__overlay__ {

			smart_ldo@28 {
				compatible = "mediatek,camera_smart_ldo";
				reg = <0x28>;
				status = "okay";
				phandle = <0x51>;
			};
		};
	};

	fragment@8 {
		target = <0xffffffff>;

		__overlay__ {
			pinctrl-names = "default\0hw_ch0_high\0hw_ch0_low\0hw_ch1_high\0hw_ch1_low";
			pinctrl-0 = <0x26>;
			pinctrl-1 = <0x27>;
			pinctrl-2 = <0x28>;
			pinctrl-3 = <0x29>;
			pinctrl-4 = <0x2a>;
			status = "okay";
		};
	};

	fragment@9 {
		target = <0xffffffff>;

		__overlay__ {

			flashlightdefault {
				phandle = <0x26>;
			};

			flashlightenoutput1 {
				phandle = <0x27>;

				pins_cmd_dat {
					pinmux = <0x9d00>;
					slew-rate = <0x01>;
					output-high;
				};
			};

			flashlightenoutput0 {
				phandle = <0x28>;

				pins_cmd_dat {
					pinmux = <0x9d00>;
					slew-rate = <0x01>;
					output-low;
				};
			};

			flashlightseloutput1 {
				phandle = <0x29>;

				pins_cmd_dat {
					pinmux = <0x9b00>;
					slew-rate = <0x01>;
					output-high;
				};
			};

			flashlightseloutput0 {
				phandle = <0x2a>;

				pins_cmd_dat {
					pinmux = <0x9b00>;
					slew-rate = <0x01>;
					output-low;
				};
			};
		};
	};

	fragment@10 {
		target = <0xffffffff>;

		__overlay__ {

			sia81xx@L {
				compatible = "si,sia81xx";
				si,sia81xx_type = "sia8152";
				si,sia81xx_disable_pin = <0x01>;
				timer_task_hdl = <0x00>;
				channel_num = <0x00>;
				owi_mode = <0x01>;
				en_x_filter = <0x00>;
				en_dynamic_updata_vdd = <0x01>;
				en_dynamic_updata_pvdd = <0x01>;
				dynamic_updata_vdd_port = <0x02>;
				phandle = <0x2b>;
			};
		};
	};

	fragment@11 {
		target = <0xffffffff>;

		__overlay__ {
			si,sia81xx-max-num = <0x01>;
			si,sia81xx-aux-devs = <0x2b>;
			si,sia81xx-aux-dev-name = "soc:odm:sia81xx@L";
			si,sia81xx-aux-devs-prefix = "SpkrLeft";
		};
	};

	fragment@12 {
		target = <0xffffffff>;

		__overlay__ {
			#address-cells = <0x01>;
			#size-cells = <0x00>;
			clock-frequency = <0x61a80>;
			mediatek,use-open-drain;

			sia81xx_i2c@L {
				compatible = "si,sia81xx-i2c";
				reg = <0x5b>;
				si,sia81xx-dev = <0x2b>;
				phandle = <0x52>;
			};
		};
	};

	fragment@13 {
		target = <0xffffffff>;

		__overlay__ {
		};
	};

	fragment@14 {
		target = <0xffffffff>;

		__overlay__ {
			pwm_ch = <0x00>;
		};
	};

	fragment@15 {
		target = <0xffffffff>;

		__overlay__ {
			compatible = "mediatek,disp-leds";

			backlight {
				led_mode = <0x04>;
				gate_enable = <0x01>;
				max-brightness = <0x7ff>;
				pwm_config = <0x00 0x01 0x00 0x00 0x00>;
			};
		};
	};

	fragment@16 {
		target = <0xffffffff>;

		__overlay__ {

			MTEE {
				compatible = "mediatek,mtk_svp_on_mtee_support";
				phandle = <0x53>;
			};

			SecureVideoPath {
				compatible = "mediatek,mtk_sec_video_path_support";
				phandle = <0x54>;
			};
		};
	};

	fragment@17 {
		target = <0xffffffff>;

		__overlay__ {

			lcm_led_en1_gpio {
				phandle = <0x2c>;

				pins_cmd_dat {
					pinmux = <0xc00>;
					slew-rate = <0x01>;
					output-high;
				};
			};

			lcm_led_en0_gpio {
				phandle = <0x2d>;

				pins_cmd_dat {
					pinmux = <0xc00>;
					slew-rate = <0x01>;
					output-low;
				};
			};

			lcm_rst_out1_gpio {
				phandle = <0x2e>;

				pins_cmd_dat {
					pinmux = <0x5500>;
					slew-rate = <0x01>;
					output-high;
				};
			};

			lcm_rst_out0_gpio {
				phandle = <0x2f>;

				pins_cmd_dat {
					pinmux = <0x5500>;
					slew-rate = <0x01>;
					output-low;
				};
			};

			lcm_dsi_te {
				phandle = <0x30>;

				pins_cmd_dat {
					pinmux = <0x5301>;
				};
			};
		};
	};

	fragment@18 {
		target = <0xffffffff>;

		__overlay__ {
			pinctrl-names = "lcm_led_en1_gpio\0lcm_led_en0_gpio\0lcm_rst_out1_gpio\0lcm_rst_out0_gpio\0mode_te_te";
			pinctrl-0 = <0x2c>;
			pinctrl-1 = <0x2d>;
			pinctrl-2 = <0x2e>;
			pinctrl-3 = <0x2f>;
			pinctrl-4 = <0x30>;
			status = "okay";
		};
	};

	fragment@19 {
		target = <0xffffffff>;

		__overlay__ {
			pinctrl-names = "lcm_rst_out1_gpio\0lcm_rst_out0_gpio\0mode_te_te";
			pinctrl-0 = <0x2e>;
			pinctrl-1 = <0x2f>;
			pinctrl-2 = <0x30>;
			status = "okay";
		};
	};

	fragment@20 {
		target = <0xffffffff>;

		__overlay__ {
			status = "okay";
			#address-cells = <0x01>;
			#size-cells = <0x00>;

			panel1@0 {
				compatible = "nt36672c,tianma,vdo";
				reg = <0x00>;
				pm-enable-gpios = <0xffffffff 0x0c 0x00>;
				reset-gpios = <0xffffffff 0x55 0x00>;
				bias-gpios = <0xffffffff 0x99 0x00 0xffffffff 0x9a 0x00>;
				pinctrl-names = "default";

				port {

					endpoint {
						remote-endpoint = <0x31>;
						phandle = <0x32>;
					};
				};
			};

			panel2@0 {
				compatible = "ft8722,jdi,vdo";
				reg = <0x01>;
				pm-enable-gpios = <0xffffffff 0x0c 0x00>;
				reset-gpios = <0xffffffff 0x55 0x00>;
				bias-gpios = <0xffffffff 0x99 0x00 0xffffffff 0x9a 0x00>;
				pinctrl-names = "default";

				port {

					endpoint {
						remote-endpoint = <0x31>;
						phandle = <0x55>;
					};
				};
			};

			ports {

				port {

					endpoint {
						remote-endpoint = <0x32>;
						phandle = <0x31>;
					};
				};
			};
		};
	};

	fragment@21 {
		target = <0xffffffff>;

		__overlay__ {

			gps_default {
				phandle = <0x33>;
			};

			gps_l1_lna@0 {
				phandle = <0x34>;

				pins_cmd_dat {
					pinmux = <0x1900>;
					output-low;
				};
			};

			gps_l1_lna@1 {
				phandle = <0x35>;

				pins_cmd_dat {
					pinmux = <0x1902>;
				};
			};

			gps_l1_lna@2 {
				phandle = <0x36>;

				pins_cmd_dat {
					pinmux = <0x1900>;
					output-high;
				};
			};

			gps_l5_lna@0 {
				phandle = <0x37>;

				pins_cmd_dat {
					pinmux = <0x1a00>;
					output-low;
				};
			};

			gps_l5_lna@1 {
				phandle = <0x38>;

				pins_cmd_dat {
					pinmux = <0x1a02>;
				};
			};

			gps_l5_lna@2 {
				phandle = <0x39>;

				pins_cmd_dat {
					pinmux = <0x1a00>;
					output-high;
				};
			};
		};
	};

	fragment@22 {
		target = <0xffffffff>;

		__overlay__ {
			pinctrl-names = "default\0gps_l1_lna_disable\0gps_l1_lna_dsp_ctrl\0gps_l1_lna_enable\0gps_l5_lna_disable\0gps_l5_lna_dsp_ctrl\0gps_l5_lna_enable";
			pinctrl-0 = <0x33>;
			pinctrl-1 = <0x34>;
			pinctrl-2 = <0x35>;
			pinctrl-3 = <0x36>;
			pinctrl-4 = <0x37>;
			pinctrl-5 = <0x38>;
			pinctrl-6 = <0x39>;
			status = "okay";
		};
	};

	fragment@23 {
		target = <0xffffffff>;

		__overlay__ {

			focaltech@0 {
				compatible = "focaltech,fts";
				reg = <0x01>;
				status = "ok";
				spi-max-frequency = <0x5b8d80>;
				interrupt-parent = <0xffffffff>;
				interrupts = <0x01 0x02>;
				focaltech,reset-gpio = <0xffffffff 0x98 0x00>;
				focaltech,irq-gpio = <0xffffffff 0x09 0x2001>;
				focaltech,max-touch-number = <0x0a>;
				focaltech,display-coords = <0x00 0x00 0x438 0x968>;
			};

			novatek@0 {
				compatible = "novatek,NVT-ts-spi";
				reg = <0x00>;
				status = "ok";
				spi-max-frequency = <0x927c00>;
				novatek,reset-gpio = <0xffffffff 0x98 0x00>;
				novatek,irq-gpio = <0xffffffff 0x09 0x2001>;
				novatek,swrst-n8-addr = <0x3f0fe>;
				novatek,spi-rd-fast-addr = <0x3f310>;
				novatek,mp-support-dt;

				novatek-mp-criteria-596E@0 {
					#address-cells = <0x01>;
					#size-cells = <0x00>;
					compatible = "novatek-mp-criteria-596E";
					IC_X_CFG_SIZE = <0x10>;
					IC_Y_CFG_SIZE = <0x24>;
					IC_KEY_CFG_SIZE = <0x04>;
					X_Channel = <0x10>;
					Y_Channel = <0x24>;
					AIN_X = <0x00 0x01 0x02 0x03 0x04 0x05 0x06 0x07 0x08 0x09 0x0a 0x0b 0x0c 0x0d 0x0e 0x0f>;
					AIN_Y = <0x00 0x01 0x02 0x03 0x04 0x05 0x06 0x07 0x08 0x09 0x0a 0x0b 0x0c 0x0d 0x0e 0x0f 0x10 0x11 0x12 0x13 0x14 0x15 0x16 0x17 0x18 0x19 0x1a 0x1b 0x1c 0x1d 0x1e 0x1f 0x20 0x21 0x22 0x23>;
					AIN_KEY = <0x00 0x01 0x02 0xff>;
					PS_Config_Lmt_Short_Rawdata_P = <0x36b8 0x36b8 0x36b8 0x36b8 0x36b8 0x36b8 0x36b8 0x36b8 0x36b8 0x36b8 0x36b8 0x36b8 0x36b8 0x36b8 0x36b8 0x36b8 0x36b8 0x36b8 0x36b8 0x36b8 0x36b8 0x36b8 0x36b8 0x36b8 0x36b8 0x36b8 0x36b8 0x36b8 0x36b8 0x36b8 0x36b8 0x36b8 0x36b8 0x36b8 0x36b8 0x36b8 0x36b8 0x36b8 0x36b8 0x36b8 0x36b8 0x36b8 0x36b8 0x36b8 0x36b8 0x36b8 0x36b8 0x36b8 0x36b8 0x36b8 0x36b8 0x36b8 0x36b8 0x36b8 0x36b8 0x36b8 0x36b8 0x36b8 0x36b8 0x36b8 0x36b8 0x36b8 0x36b8 0x36b8 0x36b8 0x36b8 0x36b8 0x36b8 0x36b8 0x36b8 0x36b8 0x36b8 0x36b8 0x36b8 0x36b8 0x36b8 0x36b8 0x36b8 0x36b8 0x36b8 0x36b8 0x36b8 0x36b8 0x36b8 0x36b8 0x36b8 0x36b8 0x36b8 0x36b8 0x36b8 0x36b8 0x36b8 0x36b8 0x36b8 0x36b8 0x36b8 0x36b8 0x36b8 0x36b8 0x36b8 0x36b8 0x36b8 0x36b8 0x36b8 0x36b8 0x36b8 0x36b8 0x36b8 0x36b8 0x36b8 0x36b8 0x36b8 0x36b8 0x36b8 0x36b8 0x36b8 0x36b8 0x36b8 0x36b8 0x36b8 0x36b8 0x36b8 0x36b8 0x36b8 0x36b8 0x36b8 0x36b8 0x36b8 0x36b8 0x36b8 0x36b8 0x36b8 0x36b8 0x36b8 0x36b8 0x36b8 0x36b8 0x36b8 0x36b8 0x36b8 0x36b8 0x36b8 0x36b8 0x36b8 0x36b8 0x36b8 0x36b8 0x36b8 0x36b8 0x36b8 0x36b8 0x36b8 0x36b8 0x36b8 0x36b8 0x36b8 0x36b8 0x36b8 0x36b8 0x36b8 0x36b8 0x36b8 0x36b8 0x36b8 0x36b8 0x36b8 0x36b8 0x36b8 0x36b8 0x36b8 0x36b8 0x36b8 0x36b8 0x36b8 0x36b8 0x36b8 0x36b8 0x36b8 0x36b8 0x36b8 0x36b8 0x36b8 0x36b8 0x36b8 0x36b8 0x36b8 0x36b8 0x36b8 0x36b8 0x36b8 0x36b8 0x36b8 0x36b8 0x36b8 0x36b8 0x36b8 0x36b8 0x36b8 0x36b8 0x36b8 0x36b8 0x36b8 0x36b8 0x36b8 0x36b8 0x36b8 0x36b8 0x36b8 0x36b8 0x36b8 0x36b8 0x36b8 0x36b8 0x36b8 0x36b8 0x36b8 0x36b8 0x36b8 0x36b8 0x36b8 0x36b8 0x36b8 0x36b8 0x36b8 0x36b8 0x36b8 0x36b8 0x36b8 0x36b8 0x36b8 0x36b8 0x36b8 0x36b8 0x36b8 0x36b8 0x36b8 0x36b8 0x36b8 0x36b8 0x36b8 0x36b8 0x36b8 0x36b8 0x36b8 0x36b8 0x36b8 0x36b8 0x36b8 0x36b8 0x36b8 0x36b8 0x36b8 0x36b8 0x36b8 0x36b8 0x36b8 0x36b8 0x36b8 0x36b8 0x36b8 0x36b8 0x36b8 0x36b8 0x36b8 0x36b8 0x36b8 0x36b8 0x36b8 0x36b8 0x36b8 0x36b8 0x36b8 0x36b8 0x36b8 0x36b8 0x36b8 0x36b8 0x36b8 0x36b8 0x36b8 0x36b8 0x36b8 0x36b8 0x36b8 0x36b8 0x36b8 0x36b8 0x36b8 0x36b8 0x36b8 0x36b8 0x36b8 0x36b8 0x36b8 0x36b8 0x36b8 0x36b8 0x36b8 0x36b8 0x36b8 0x36b8 0x36b8 0x36b8 0x36b8 0x36b8 0x36b8 0x36b8 0x36b8 0x36b8 0x36b8 0x36b8 0x36b8 0x36b8 0x36b8 0x36b8 0x36b8 0x36b8 0x36b8 0x36b8 0x36b8 0x36b8 0x36b8 0x36b8 0x36b8 0x36b8 0x36b8 0x36b8 0x36b8 0x36b8 0x36b8 0x36b8 0x36b8 0x36b8 0x36b8 0x36b8 0x36b8 0x36b8 0x36b8 0x36b8 0x36b8 0x36b8 0x36b8 0x36b8 0x36b8 0x36b8 0x36b8 0x36b8 0x36b8 0x36b8 0x36b8 0x36b8 0x36b8 0x36b8 0x36b8 0x36b8 0x36b8 0x36b8 0x36b8 0x36b8 0x36b8 0x36b8 0x36b8 0x36b8 0x36b8 0x36b8 0x36b8 0x36b8 0x36b8 0x36b8 0x36b8 0x36b8 0x36b8 0x36b8 0x36b8 0x36b8 0x36b8 0x36b8 0x36b8 0x36b8 0x36b8 0x36b8 0x36b8 0x36b8 0x36b8 0x36b8 0x36b8 0x36b8 0x36b8 0x36b8 0x36b8 0x36b8 0x36b8 0x36b8 0x36b8 0x36b8 0x36b8 0x36b8 0x36b8 0x36b8 0x36b8 0x36b8 0x36b8 0x36b8 0x36b8 0x36b8 0x36b8 0x36b8 0x36b8 0x36b8 0x36b8 0x36b8 0x36b8 0x36b8 0x36b8 0x36b8 0x36b8 0x36b8 0x36b8 0x36b8 0x36b8 0x36b8 0x36b8 0x36b8 0x36b8 0x36b8 0x36b8 0x36b8 0x36b8 0x36b8 0x36b8 0x36b8 0x36b8 0x36b8 0x36b8 0x36b8 0x36b8 0x36b8 0x36b8 0x36b8 0x36b8 0x36b8 0x36b8 0x36b8 0x36b8 0x36b8 0x36b8 0x36b8 0x36b8 0x36b8 0x36b8 0x36b8 0x36b8 0x36b8 0x36b8 0x36b8 0x36b8 0x36b8 0x36b8 0x36b8 0x36b8 0x36b8 0x36b8 0x36b8 0x36b8 0x36b8 0x36b8 0x36b8 0x36b8 0x36b8 0x36b8 0x36b8 0x36b8 0x36b8 0x36b8 0x36b8 0x36b8 0x36b8 0x36b8 0x36b8 0x36b8 0x36b8 0x36b8 0x36b8 0x36b8 0x36b8 0x36b8 0x36b8 0x36b8 0x36b8 0x36b8 0x36b8 0x36b8 0x36b8 0x36b8 0x36b8 0x36b8 0x36b8 0x36b8 0x36b8 0x36b8 0x36b8 0x36b8 0x36b8 0x36b8 0x36b8 0x36b8 0x36b8 0x36b8 0x36b8 0x36b8 0x36b8 0x36b8 0x36b8 0x36b8 0x36b8 0x36b8 0x36b8 0x36b8 0x36b8 0x36b8 0x36b8 0x36b8 0x36b8 0x36b8 0x36b8 0x36b8 0x36b8 0x36b8 0x36b8 0x36b8 0x36b8 0x36b8 0x36b8 0x36b8 0x36b8 0x36b8 0x36b8 0x36b8 0x36b8 0x36b8 0x36b8 0x36b8 0x36b8 0x36b8 0x36b8 0x36b8 0x36b8 0x36b8 0x36b8 0x36b8 0x36b8 0x36b8 0x36b8 0x36b8 0x36b8 0x36b8 0x36b8 0x36b8 0x36b8 0x36b8 0x36b8 0x36b8 0x36b8 0x36b8 0x36b8 0x36b8 0x36b8 0x36b8 0x36b8 0x36b8 0x36b8 0x36b8 0x36b8 0x36b8 0x36b8 0x36b8 0x36b8 0x36b8 0x36b8>;
					PS_Config_Lmt_Short_Rawdata_N = <0x2774 0x2774 0x2774 0x2774 0x2774 0x2774 0x2774 0x2774 0x2774 0x2774 0x2774 0x2774 0x2774 0x2774 0x2774 0x2774 0x2774 0x2774 0x2774 0x2774 0x2774 0x2774 0x2774 0x2774 0x2774 0x2774 0x2774 0x2774 0x2774 0x2774 0x2774 0x2774 0x2774 0x2774 0x2774 0x2774 0x2774 0x2774 0x2774 0x2774 0x2774 0x2774 0x2774 0x2774 0x2774 0x2774 0x2774 0x2774 0x2774 0x2774 0x2774 0x2774 0x2774 0x2774 0x2774 0x2774 0x2774 0x2774 0x2774 0x2774 0x2774 0x2774 0x2774 0x2774 0x2774 0x2774 0x2774 0x2774 0x2774 0x2774 0x2774 0x2774 0x2774 0x2774 0x2774 0x2774 0x2774 0x2774 0x2774 0x2774 0x2774 0x2774 0x2774 0x2774 0x2774 0x2774 0x2774 0x2774 0x2774 0x2774 0x2774 0x2774 0x2774 0x2774 0x2774 0x2774 0x2774 0x2774 0x2774 0x2774 0x2774 0x2774 0x2774 0x2774 0x2774 0x2774 0x2774 0x2774 0x2774 0x2774 0x2774 0x2774 0x2774 0x2774 0x2774 0x2774 0x2774 0x2774 0x2774 0x2774 0x2774 0x2774 0x2774 0x2774 0x2774 0x2774 0x2774 0x2774 0x2774 0x2774 0x2774 0x2774 0x2774 0x2774 0x2774 0x2774 0x2774 0x2774 0x2774 0x2774 0x2774 0x2774 0x2774 0x2774 0x2774 0x2774 0x2774 0x2774 0x2774 0x2774 0x2774 0x2774 0x2774 0x2774 0x2774 0x2774 0x2774 0x2774 0x2774 0x2774 0x2774 0x2774 0x2774 0x2774 0x2774 0x2774 0x2774 0x2774 0x2774 0x2774 0x2774 0x2774 0x2774 0x2774 0x2774 0x2774 0x2774 0x2774 0x2774 0x2774 0x2774 0x2774 0x2774 0x2774 0x2774 0x2774 0x2774 0x2774 0x2774 0x2774 0x2774 0x2774 0x2774 0x2774 0x2774 0x2774 0x2774 0x2774 0x2774 0x2774 0x2774 0x2774 0x2774 0x2774 0x2774 0x2774 0x2774 0x2774 0x2774 0x2774 0x2774 0x2774 0x2774 0x2774 0x2774 0x2774 0x2774 0x2774 0x2774 0x2774 0x2774 0x2774 0x2774 0x2774 0x2774 0x2774 0x2774 0x2774 0x2774 0x2774 0x2774 0x2774 0x2774 0x2774 0x2774 0x2774 0x2774 0x2774 0x2774 0x2774 0x2774 0x2774 0x2774 0x2774 0x2774 0x2774 0x2774 0x2774 0x2774 0x2774 0x2774 0x2774 0x2774 0x2774 0x2774 0x2774 0x2774 0x2774 0x2774 0x2774 0x2774 0x2774 0x2774 0x2774 0x2774 0x2774 0x2774 0x2774 0x2774 0x2774 0x2774 0x2774 0x2774 0x2774 0x2774 0x2774 0x2774 0x2774 0x2774 0x2774 0x2774 0x2774 0x2774 0x2774 0x2774 0x2774 0x2774 0x2774 0x2774 0x2774 0x2774 0x2774 0x2774 0x2774 0x2774 0x2774 0x2774 0x2774 0x2774 0x2774 0x2774 0x2774 0x2774 0x2774 0x2774 0x2774 0x2774 0x2774 0x2774 0x2774 0x2774 0x2774 0x2774 0x2774 0x2774 0x2774 0x2774 0x2774 0x2774 0x2774 0x2774 0x2774 0x2774 0x2774 0x2774 0x2774 0x2774 0x2774 0x2774 0x2774 0x2774 0x2774 0x2774 0x2774 0x2774 0x2774 0x2774 0x2774 0x2774 0x2774 0x2774 0x2774 0x2774 0x2774 0x2774 0x2774 0x2774 0x2774 0x2774 0x2774 0x2774 0x2774 0x2774 0x2774 0x2774 0x2774 0x2774 0x2774 0x2774 0x2774 0x2774 0x2774 0x2774 0x2774 0x2774 0x2774 0x2774 0x2774 0x2774 0x2774 0x2774 0x2774 0x2774 0x2774 0x2774 0x2774 0x2774 0x2774 0x2774 0x2774 0x2774 0x2774 0x2774 0x2774 0x2774 0x2774 0x2774 0x2774 0x2774 0x2774 0x2774 0x2774 0x2774 0x2774 0x2774 0x2774 0x2774 0x2774 0x2774 0x2774 0x2774 0x2774 0x2774 0x2774 0x2774 0x2774 0x2774 0x2774 0x2774 0x2774 0x2774 0x2774 0x2774 0x2774 0x2774 0x2774 0x2774 0x2774 0x2774 0x2774 0x2774 0x2774 0x2774 0x2774 0x2774 0x2774 0x2774 0x2774 0x2774 0x2774 0x2774 0x2774 0x2774 0x2774 0x2774 0x2774 0x2774 0x2774 0x2774 0x2774 0x2774 0x2774 0x2774 0x2774 0x2774 0x2774 0x2774 0x2774 0x2774 0x2774 0x2774 0x2774 0x2774 0x2774 0x2774 0x2774 0x2774 0x2774 0x2774 0x2774 0x2774 0x2774 0x2774 0x2774 0x2774 0x2774 0x2774 0x2774 0x2774 0x2774 0x2774 0x2774 0x2774 0x2774 0x2774 0x2774 0x2774 0x2774 0x2774 0x2774 0x2774 0x2774 0x2774 0x2774 0x2774 0x2774 0x2774 0x2774 0x2774 0x2774 0x2774 0x2774 0x2774 0x2774 0x2774 0x2774 0x2774 0x2774 0x2774 0x2774 0x2774 0x2774 0x2774 0x2774 0x2774 0x2774 0x2774 0x2774 0x2774 0x2774 0x2774 0x2774 0x2774 0x2774 0x2774 0x2774 0x2774 0x2774 0x2774 0x2774 0x2774 0x2774 0x2774 0x2774 0x2774 0x2774 0x2774 0x2774 0x2774 0x2774 0x2774 0x2774 0x2774 0x2774 0x2774 0x2774 0x2774 0x2774 0x2774 0x2774 0x2774 0x2774 0x2774 0x2774 0x2774 0x2774 0x2774 0x2774 0x2774 0x2774 0x2774 0x2774 0x2774 0x2774 0x2774 0x2774 0x2774 0x2774 0x2774 0x2774 0x2774 0x2774 0x2774 0x2774 0x2774 0x2774 0x2774 0x2774 0x2774 0x2774 0x2774 0x2774 0x2774 0x2774 0x2774 0x2774 0x2710 0x2710 0x2710>;
					PS_Config_Lmt_Open_Rawdata_P = <0x680 0x691 0x6a2 0x6b0 0x6aa 0x6a7 0x698 0xffff 0xffff 0x68d 0x69c 0x6a9 0x6b8 0x6ba 0x6a5 0x6a7 0x69e 0x6a7 0x6c1 0x6d6 0x6d1 0x6d0 0x6d0 0x6b4 0x67c 0x6a7 0x6a7 0x6b5 0x6c3 0x6bc 0x6aa 0x6b4 0x668 0x682 0x698 0x6b1 0x6ad 0x6aa 0x6aa 0x69f 0x68a 0x6ad 0x6ae 0x6be 0x6cc 0x6c1 0x6ae 0x6b4 0x6b5 0x6b5 0x6d0 0x6ef 0x6e9 0x6e5 0x6e8 0x6da 0x6ad 0x6bf 0x6c1 0x6d3 0x6de 0x6cd 0x6ba 0x6c1 0x6b4 0x6ba 0x6d0 0x6ef 0x6ec 0x6e6 0x6e5 0x6d8 0x6dd 0x6ec 0x6e9 0x700 0x705 0x6f7 0x6e4 0x6eb 0x6cf 0x6c6 0x6e6 0x708 0x702 0x702 0x6fd 0x6f2 0x6ca 0x6cc 0x6d3 0x6e6 0x6eb 0x6d8 0x6c8 0x6d1 0x6e2 0x6ed 0x6fb 0x719 0x71a 0x71a 0x713 0x708 0x705 0x717 0x70e 0x720 0x723 0x717 0x701 0x710 0x6e1 0x6ed 0x6ed 0x717 0x71a 0x71c 0x717 0x709 0x713 0x721 0x709 0x727 0x725 0x717 0x704 0x70f 0x705 0x712 0x721 0x739 0x73d 0x741 0x73a 0x72c 0x715 0x721 0x71a 0x727 0x721 0x715 0x6fe 0x710 0x701 0x70b 0x71c 0x731 0x739 0x739 0x735 0x721 0x72c 0x73a 0x731 0x73a 0x731 0x723 0x709 0x723 0x701 0x715 0x720 0x72a 0x73c 0x73f 0x738 0x72b 0x735 0x747 0x73c 0x739 0x738 0x72e 0x713 0x728 0x724 0x738 0x740 0x75d 0x75c 0x763 0x758 0x748 0x748 0x75d 0x74e 0x75d 0x746 0x73f 0x724 0x738 0x73d 0x754 0x75d 0x775 0x76b 0x780 0x775 0x762 0x748 0x758 0x74e 0x756 0x72e 0x735 0x71c 0x731 0x756 0x76e 0x77e 0x794 0x79f 0x79f 0x797 0x77c 0x77f 0x791 0x785 0x793 0x772 0x767 0x74a 0x764 0x743 0x75b 0x764 0x77e 0x786 0x783 0x779 0x763 0x767 0x777 0x769 0x778 0x759 0x744 0x731 0x748 0x76a 0x785 0x791 0x7a9 0x7b7 0x7a3 0x7aa 0x797 0x791 0x79e 0x793 0x7a3 0x77f 0x75c 0x74f 0x76a 0x760 0x77f 0x77f 0x79a 0x7a5 0x7a5 0x795 0x780 0x7a2 0x7b3 0x7a3 0x7b6 0x78e 0x77e 0x759 0x778 0x772 0x791 0x794 0x7b0 0x7be 0x7bf 0x7ac 0x79c 0x7bf 0x7d0 0x7c4 0x7d2 0x7ac 0x79b 0x76e 0x793 0x78c 0x76d 0x763 0x76b 0x752 0x755 0x743 0x74d 0x720 0x752 0x746 0x751 0x74f 0x75f 0x752 0x76b 0x791 0x774 0x76b 0x771 0x75d 0x75f 0x74f 0x752 0x732 0x764 0x756 0x763 0x762 0x772 0x76a 0x77c 0x79c 0x78a 0x77e 0x785 0x76e 0x771 0x760 0x754 0x76b 0x795 0x78c 0x798 0x797 0x7a6 0x79c 0x79a 0x7b7 0x79f 0x798 0x7a1 0x789 0x78a 0x77e 0x77f 0x771 0x79e 0x798 0x7a3 0x7a3 0x7b0 0x7a2 0x7ad 0x7bb 0x7b0 0x7a3 0x7ad 0x798 0x793 0x785 0x782 0x76b 0x79a 0x790 0x7a3 0x79f 0x7aa 0x79e 0x7ac 0x7c6 0x7b8 0x7ac 0x7bb 0x7a1 0x79c 0x790 0x790 0x78a 0x7b6 0x7af 0x7c1 0x7ba 0x7c1 0x7b3 0x7bf 0x7bd 0x7b4 0x7aa 0x7b3 0x79c 0x79a 0x78a 0x78a 0x76b 0x795 0x78d 0x7a2 0x79b 0x7a9 0x79b 0x7a6 0x7b8 0x7b6 0x7a9 0x7b4 0x79b 0x79e 0x78d 0x78e 0x783 0x7ac 0x7a2 0x7b4 0x7ad 0x7b8 0x7a9 0x7b1 0x7c6 0x7c6 0x7bf 0x7c8 0x7af 0x7ac 0x79e 0x79e 0x779 0x79f 0x798 0x7ad 0x7a8 0x7b6 0x7ac 0x7b1 0x7bd 0x7bf 0x7ba 0x7c2 0x7a9 0x7a9 0x79e 0x79a 0x782 0x7a9 0x7a1 0x7b4 0x7ac 0x7ba 0x7ad 0x7b3 0x7c1 0x7cb 0x7bf 0x7c9 0x7ad 0x7b0 0x7a2 0x79f 0x777 0x7a1 0x794 0x7ac 0x7a2 0x7b1 0x7a5 0x7a9 0x7e4 0x7ec 0x7e2 0x7ef 0x7d3 0x7d2 0x7c6 0x7c1 0x798 0x7c1 0x7b4 0x7cb 0x7c4 0x7d3 0x7c4 0x7c9 0x7ac 0x7bf 0x7b6 0x7be 0x7a2 0x7a5 0x797 0x78e 0x78c 0x7b3 0x7ad 0x7c2 0x7ba 0x7cf 0x7ba 0x7c4 0x7de 0x7ef 0x7eb 0x7f3 0x7d9 0x7db 0x7cc 0x7c4 0x7a6 0x7cc 0x7c2 0x7d6 0x7d2 0x7e1 0x7cc 0x7d3 0x7c8 0x7db 0x7d7 0x7e0 0x7c6 0x7c6 0x7b8 0x7ad 0x7a6 0x7c9 0x7be 0x7d2 0x7cc 0x7da 0x7c4 0x7cb 0x7e0 0x7f3 0x7f2 0x7fd 0x7e1 0x7e7 0x7d6 0x7cd 0x7be 0x7e2 0x7d4 0x7e9 0x7e1 0x7f0 0x7d3 0x7dd 0x7be 0x7e5 0x7e2 0x7ec 0x7d3 0x7d6 0x7c4 0x7bb 0x7bb 0x7e2 0x7d2 0x7eb 0x7e2 0x7f5 0x7d6 0x7d3 0x716 0x747 0x7a6 0x7f2 0x7d4 0x7d7 0x7c1 0x7b7 0x7ac 0x7d6 0x7c4 0x7db 0x7d6 0x7a9 0x732 0x70c 0x1400 0x1400 0x1400>;
					PS_Config_Lmt_Open_Rawdata_N = <0x2c9 0x2d0 0x2d7 0x2dd 0x2db 0x2da 0x2d3 0xffff0001 0xffff0001 0x2ce 0x2d5 0x2da 0x2e1 0x2e2 0x2d9 0x2da 0x2d6 0x2da 0x2e5 0x2ee 0x2ec 0x2eb 0x2eb 0x2df 0x2c7 0x2da 0x2da 0x2e0 0x2e6 0x2e3 0x2db 0x2df 0x2bf 0x2ca 0x2d3 0x2de 0x2dc 0x2db 0x2db 0x2d6 0x2cd 0x2dc 0x2dd 0x2e3 0x2e9 0x2e5 0x2dd 0x2df 0x2e0 0x2e0 0x2eb 0x2f8 0x2f6 0x2f4 0x2f5 0x2ef 0x2dc 0x2e4 0x2e5 0x2ec 0x2f1 0x2ea 0x2e2 0x2e5 0x2df 0x2e2 0x2eb 0x2f8 0x2f7 0x2f5 0x2f4 0x2ef 0x2f1 0x2f7 0x2f6 0x300 0x302 0x2fc 0x2f4 0x2f7 0x2eb 0x2e7 0x2f5 0x303 0x301 0x301 0x2fe 0x2fa 0x2e9 0x2e9 0x2ec 0x2f5 0x2f7 0x2ef 0x2e8 0x2ec 0x2f3 0x2f8 0x2fe 0x30a 0x30b 0x30b 0x308 0x303 0x302 0x30a 0x306 0x30d 0x30f 0x30a 0x300 0x307 0x2f2 0x2f8 0x2f8 0x30a 0x30b 0x30c 0x30a 0x304 0x308 0x30e 0x304 0x310 0x310 0x30a 0x301 0x306 0x302 0x307 0x30e 0x318 0x31a 0x31c 0x319 0x313 0x309 0x30e 0x30b 0x310 0x30e 0x309 0x2ff 0x307 0x300 0x304 0x30c 0x315 0x318 0x318 0x316 0x30e 0x313 0x319 0x315 0x319 0x315 0x30f 0x304 0x30f 0x300 0x309 0x30d 0x312 0x319 0x31b 0x318 0x312 0x316 0x31e 0x319 0x318 0x318 0x313 0x308 0x311 0x30f 0x318 0x31b 0x328 0x327 0x32a 0x325 0x31f 0x31f 0x328 0x321 0x328 0x31e 0x31b 0x30f 0x318 0x31a 0x324 0x328 0x332 0x32e 0x337 0x332 0x32a 0x31f 0x325 0x321 0x325 0x313 0x316 0x30c 0x315 0x325 0x32f 0x336 0x33f 0x344 0x344 0x340 0x335 0x336 0x33e 0x339 0x33f 0x331 0x32c 0x31f 0x32b 0x31c 0x327 0x32b 0x336 0x339 0x338 0x334 0x32a 0x32c 0x333 0x32d 0x333 0x326 0x31d 0x315 0x31f 0x32d 0x339 0x33e 0x348 0x34e 0x346 0x349 0x340 0x33e 0x343 0x33f 0x346 0x336 0x327 0x322 0x32d 0x329 0x336 0x336 0x342 0x346 0x346 0x340 0x337 0x345 0x34c 0x346 0x34e 0x33d 0x336 0x326 0x333 0x331 0x33e 0x33f 0x34b 0x351 0x352 0x349 0x343 0x352 0x359 0x354 0x35a 0x349 0x342 0x32f 0x33f 0x33c 0x32e 0x32a 0x32e 0x323 0x324 0x31c 0x321 0x30d 0x323 0x31e 0x322 0x322 0x328 0x323 0x32e 0x33e 0x331 0x32e 0x330 0x328 0x328 0x322 0x323 0x315 0x32b 0x325 0x32a 0x32a 0x331 0x32d 0x335 0x343 0x33b 0x336 0x339 0x32f 0x330 0x329 0x324 0x32e 0x340 0x33c 0x341 0x340 0x347 0x343 0x342 0x34e 0x344 0x341 0x345 0x33a 0x33b 0x336 0x336 0x330 0x343 0x341 0x346 0x346 0x34b 0x345 0x34a 0x350 0x34b 0x346 0x34a 0x341 0x33f 0x339 0x337 0x32e 0x342 0x33d 0x346 0x344 0x349 0x343 0x349 0x355 0x34f 0x349 0x350 0x345 0x343 0x33d 0x33d 0x33b 0x34e 0x34b 0x352 0x34f 0x352 0x34c 0x352 0x351 0x34d 0x349 0x34c 0x343 0x342 0x33b 0x33b 0x32e 0x340 0x33c 0x345 0x342 0x348 0x342 0x347 0x34f 0x34e 0x348 0x34d 0x342 0x343 0x33c 0x33d 0x338 0x349 0x345 0x34d 0x34a 0x34f 0x348 0x34c 0x355 0x355 0x352 0x355 0x34b 0x349 0x343 0x343 0x334 0x344 0x341 0x34a 0x348 0x34e 0x349 0x34c 0x351 0x352 0x34f 0x353 0x348 0x348 0x343 0x342 0x337 0x348 0x345 0x34d 0x349 0x34f 0x34a 0x34c 0x352 0x357 0x352 0x356 0x34a 0x34b 0x345 0x344 0x333 0x345 0x33f 0x349 0x345 0x34c 0x346 0x348 0x361 0x365 0x361 0x366 0x35a 0x35a 0x355 0x352 0x341 0x352 0x34d 0x357 0x354 0x35a 0x354 0x356 0x349 0x352 0x34e 0x351 0x345 0x346 0x340 0x33d 0x33c 0x34c 0x34a 0x353 0x34f 0x358 0x34f 0x354 0x35f 0x366 0x364 0x368 0x35d 0x35e 0x357 0x354 0x347 0x357 0x353 0x35b 0x35a 0x360 0x357 0x35a 0x355 0x35e 0x35c 0x360 0x355 0x355 0x34f 0x34a 0x347 0x356 0x351 0x35a 0x357 0x35d 0x354 0x357 0x360 0x368 0x367 0x36c 0x360 0x363 0x35b 0x358 0x351 0x361 0x35b 0x364 0x360 0x367 0x35a 0x35e 0x351 0x362 0x361 0x365 0x35a 0x35b 0x354 0x350 0x350 0x361 0x35a 0x364 0x361 0x369 0x35b 0x35a 0x309 0x31e 0x347 0x367 0x35b 0x35c 0x352 0x34e 0x349 0x35b 0x354 0x35e 0x35b 0x348 0x315 0x305 0xfffffe01 0xfffffe01 0xfffffe01>;
					PS_Config_Lmt_FW_Rawdata_P = <0x467 0x450 0x462 0x464 0x460 0x465 0x45a 0xffff 0xffff 0x45a 0x45d 0x45a 0x462 0x460 0x45e 0x457 0x464 0x444 0x441 0x453 0x44c 0x456 0x453 0x460 0x460 0x465 0x45a 0x45e 0x45d 0x45e 0x459 0x462 0x453 0x464 0x459 0x43e 0x456 0x445 0x446 0x44c 0x449 0x445 0x444 0x453 0x43e 0x448 0x44f 0x459 0x45d 0x44c 0x457 0x454 0x44f 0x450 0x452 0x46e 0x45d 0x46c 0x469 0x468 0x465 0x461 0x465 0x45d 0x461 0x453 0x45a 0x468 0x45d 0x462 0x460 0x457 0x468 0x462 0x45a 0x46c 0x45d 0x461 0x461 0x46b 0x461 0x45a 0x460 0x450 0x45d 0x454 0x45a 0x464 0x445 0x446 0x441 0x43f 0x441 0x445 0x46b 0x45e 0x46c 0x44b 0x448 0x457 0x44f 0x468 0x457 0x46b 0x469 0x465 0x462 0x462 0x462 0x462 0x452 0x469 0x45a 0x45a 0x469 0x472 0x465 0x46e 0x475 0x46f 0x461 0x460 0x452 0x454 0x457 0x44d 0x445 0x460 0x468 0x459 0x45a 0x45e 0x45e 0x465 0x45b 0x460 0x46b 0x468 0x467 0x45b 0x465 0x461 0x45b 0x461 0x469 0x45e 0x465 0x479 0x469 0x473 0x47d 0x44c 0x45d 0x45a 0x454 0x44f 0x456 0x456 0x459 0x462 0x46c 0x464 0x457 0x469 0x460 0x470 0x468 0x467 0x472 0x472 0x456 0x456 0x45e 0x452 0x44f 0x47e 0x469 0x457 0x45d 0x460 0x45d 0x46b 0x45e 0x475 0x44d 0x44d 0x464 0x464 0x45d 0x472 0x470 0x45d 0x456 0x467 0x461 0x469 0x46e 0x454 0x468 0x456 0x460 0x460 0x456 0x45b 0x461 0x450 0x460 0x46b 0x464 0x469 0x462 0x45e 0x464 0x45a 0x456 0x464 0x462 0x461 0x469 0x46c 0x469 0x461 0x44f 0x44d 0x459 0x43e 0x44d 0x457 0x45b 0x460 0x45d 0x468 0x45d 0x45d 0x464 0x461 0x462 0x45a 0x45d 0x457 0x44d 0x473 0x461 0x45b 0x465 0x456 0x44f 0x467 0x460 0x45d 0x45e 0x456 0x452 0x44f 0x45d 0x475 0x44c 0x459 0x461 0x45e 0x45b 0x461 0x45e 0x472 0x46e 0x460 0x454 0x461 0x453 0x469 0x464 0x462 0x475 0x460 0x450 0x467 0x45b 0x460 0x462 0x462 0x45e 0x45d 0x464 0x45d 0x457 0x457 0x44b 0x453 0x46e 0x45d 0x46b 0x461 0x46c 0x456 0x44d 0x44c 0x45b 0x45d 0x462 0x45b 0x460 0x457 0x44c 0x467 0x467 0x469 0x46c 0x465 0x476 0x464 0x459 0x45b 0x45e 0x45e 0x460 0x45d 0x461 0x45d 0x460 0x459 0x45b 0x45e 0x45d 0x460 0x45d 0x45d 0x456 0x454 0x450 0x465 0x467 0x465 0x459 0x45a 0x45e 0x46f 0x450 0x459 0x45d 0x469 0x45b 0x468 0x46f 0x472 0x47a 0x469 0x45e 0x465 0x461 0x465 0x460 0x476 0x46b 0x460 0x464 0x452 0x460 0x45e 0x460 0x465 0x465 0x462 0x45d 0x454 0x45e 0x460 0x44c 0x460 0x469 0x469 0x469 0x470 0x469 0x46b 0x461 0x465 0x46c 0x454 0x454 0x446 0x44c 0x44f 0x44c 0x467 0x464 0x45a 0x460 0x456 0x469 0x468 0x457 0x459 0x476 0x472 0x472 0x46f 0x46e 0x469 0x460 0x468 0x452 0x44b 0x44d 0x459 0x453 0x457 0x46b 0x472 0x475 0x460 0x461 0x45a 0x459 0x468 0x460 0x45d 0x467 0x45e 0x464 0x462 0x45e 0x464 0x469 0x477 0x475 0x479 0x476 0x470 0x46f 0x472 0x475 0x448 0x46e 0x462 0x462 0x460 0x45e 0x45d 0x45a 0x460 0x45d 0x465 0x45d 0x468 0x464 0x464 0x465 0x465 0x46b 0x446 0x446 0x448 0x44c 0x448 0x44d 0x44c 0x459 0x462 0x45a 0x45e 0x460 0x468 0x461 0x44d 0x45e 0x461 0x469 0x460 0x461 0x461 0x472 0x479 0x465 0x473 0x470 0x46b 0x46f 0x473 0x468 0x454 0x470 0x44f 0x456 0x449 0x44f 0x450 0x456 0x456 0x470 0x45d 0x472 0x472 0x473 0x469 0x469 0x45b 0x44b 0x46e 0x469 0x46f 0x45e 0x470 0x46e 0x472 0x45e 0x465 0x462 0x45d 0x460 0x45e 0x470 0x45d 0x459 0x475 0x469 0x477 0x45d 0x475 0x464 0x469 0x45e 0x469 0x459 0x45b 0x452 0x45a 0x46f 0x480 0x441 0x46e 0x479 0x46f 0x46b 0x472 0x475 0x456 0x460 0x465 0x45b 0x462 0x457 0x460 0x462 0x45b 0x462 0x465 0x461 0x45d 0x467 0x45d 0x460 0x45d 0x461 0x453 0x45e 0x469 0x460 0x457 0x45b 0x459 0x456 0x452 0x464 0x468 0x46e 0x464 0x467 0x456 0x450 0x456 0x47d 0x44d 0x468 0x462 0x44c 0x456 0xf00 0xf00 0xf00>;
					PS_Config_Lmt_FW_Rawdata_N = <0x1e3 0x1d9 0x1e1 0x1e1 0x1e0 0x1e2 0x1dd 0xffff0001 0xffff0001 0x1dd 0x1de 0x1dd 0x1e1 0x1e0 0x1df 0x1dc 0x1e1 0x1d4 0x1d2 0x1da 0x1d7 0x1db 0x1da 0x1e0 0x1e0 0x1e2 0x1dd 0x1df 0x1de 0x1df 0x1dd 0x1e1 0x1da 0x1e1 0x1dd 0x1d1 0x1db 0x1d4 0x1d5 0x1d7 0x1d6 0x1d4 0x1d4 0x1da 0x1d1 0x1d5 0x1d8 0x1dd 0x1de 0x1d7 0x1dc 0x1db 0x1d8 0x1d9 0x1da 0x1e6 0x1de 0x1e5 0x1e4 0x1e3 0x1e2 0x1e0 0x1e2 0x1de 0x1e0 0x1da 0x1dd 0x1e3 0x1de 0x1e1 0x1e0 0x1dc 0x1e3 0x1e1 0x1dd 0x1e5 0x1de 0x1e0 0x1e0 0x1e4 0x1e0 0x1dd 0x1e0 0x1d9 0x1de 0x1db 0x1dd 0x1e1 0x1d4 0x1d5 0x1d2 0x1d2 0x1d2 0x1d4 0x1e4 0x1df 0x1e5 0x1d7 0x1d5 0x1dc 0x1d8 0x1e3 0x1dc 0x1e4 0x1e4 0x1e2 0x1e1 0x1e1 0x1e1 0x1e1 0x1da 0x1e4 0x1dd 0x1dd 0x1e4 0x1e7 0x1e2 0x1e6 0x1e9 0x1e6 0x1e0 0x1e0 0x1da 0x1db 0x1dc 0x1d8 0x1d4 0x1e0 0x1e3 0x1dd 0x1dd 0x1df 0x1df 0x1e2 0x1de 0x1e0 0x1e4 0x1e3 0x1e3 0x1de 0x1e2 0x1e0 0x1de 0x1e0 0x1e4 0x1df 0x1e2 0x1ea 0x1e4 0x1e8 0x1ec 0x1d7 0x1de 0x1dd 0x1db 0x1d8 0x1db 0x1db 0x1dd 0x1e1 0x1e5 0x1e1 0x1dc 0x1e4 0x1e0 0x1e7 0x1e3 0x1e3 0x1e7 0x1e7 0x1db 0x1db 0x1df 0x1da 0x1d8 0x1ed 0x1e4 0x1dc 0x1de 0x1e0 0x1de 0x1e4 0x1df 0x1e9 0x1d8 0x1d8 0x1e1 0x1e1 0x1de 0x1e7 0x1e7 0x1de 0x1db 0x1e3 0x1e0 0x1e4 0x1e6 0x1db 0x1e3 0x1db 0x1e0 0x1e0 0x1db 0x1de 0x1e0 0x1d9 0x1e0 0x1e4 0x1e1 0x1e4 0x1e1 0x1df 0x1e1 0x1dd 0x1db 0x1e1 0x1e1 0x1e0 0x1e4 0x1e5 0x1e4 0x1e0 0x1d8 0x1d8 0x1dd 0x1d1 0x1d8 0x1dc 0x1de 0x1e0 0x1de 0x1e3 0x1de 0x1de 0x1e1 0x1e0 0x1e1 0x1dd 0x1de 0x1dc 0x1d8 0x1e8 0x1e0 0x1de 0x1e2 0x1db 0x1d8 0x1e3 0x1e0 0x1de 0x1df 0x1db 0x1da 0x1d8 0x1de 0x1e9 0x1d7 0x1dd 0x1e0 0x1df 0x1de 0x1e0 0x1df 0x1e7 0x1e6 0x1e0 0x1db 0x1e0 0x1da 0x1e4 0x1e1 0x1e1 0x1e9 0x1e0 0x1d9 0x1e3 0x1de 0x1e0 0x1e1 0x1e1 0x1df 0x1de 0x1e1 0x1de 0x1dc 0x1dc 0x1d7 0x1da 0x1e6 0x1de 0x1e4 0x1e0 0x1e5 0x1db 0x1d8 0x1d7 0x1de 0x1de 0x1e1 0x1de 0x1e0 0x1dc 0x1d7 0x1e3 0x1e3 0x1e4 0x1e5 0x1e2 0x1e9 0x1e1 0x1dd 0x1de 0x1df 0x1df 0x1e0 0x1de 0x1e0 0x1de 0x1e0 0x1dd 0x1de 0x1df 0x1de 0x1e0 0x1de 0x1de 0x1db 0x1db 0x1d9 0x1e2 0x1e3 0x1e2 0x1dd 0x1dd 0x1df 0x1e6 0x1d9 0x1dd 0x1de 0x1e4 0x1de 0x1e3 0x1e6 0x1e7 0x1eb 0x1e4 0x1df 0x1e2 0x1e0 0x1e2 0x1e0 0x1e9 0x1e4 0x1e0 0x1e1 0x1da 0x1e0 0x1df 0x1e0 0x1e2 0x1e2 0x1e1 0x1de 0x1db 0x1df 0x1e0 0x1d7 0x1e0 0x1e4 0x1e4 0x1e4 0x1e7 0x1e4 0x1e4 0x1e0 0x1e2 0x1e5 0x1db 0x1db 0x1d5 0x1d7 0x1d8 0x1d7 0x1e3 0x1e1 0x1dd 0x1e0 0x1db 0x1e4 0x1e3 0x1dc 0x1dd 0x1e9 0x1e7 0x1e7 0x1e6 0x1e6 0x1e4 0x1e0 0x1e3 0x1da 0x1d7 0x1d8 0x1dd 0x1da 0x1dc 0x1e4 0x1e7 0x1e9 0x1e0 0x1e0 0x1dd 0x1dd 0x1e3 0x1e0 0x1de 0x1e3 0x1df 0x1e1 0x1e1 0x1df 0x1e1 0x1e4 0x1ea 0x1e9 0x1ea 0x1e9 0x1e7 0x1e6 0x1e7 0x1e9 0x1d5 0x1e6 0x1e1 0x1e1 0x1e0 0x1df 0x1de 0x1dd 0x1e0 0x1de 0x1e2 0x1de 0x1e3 0x1e1 0x1e1 0x1e2 0x1e2 0x1e4 0x1d5 0x1d5 0x1d5 0x1d7 0x1d5 0x1d8 0x1d7 0x1dd 0x1e1 0x1dd 0x1df 0x1e0 0x1e3 0x1e0 0x1d8 0x1df 0x1e0 0x1e4 0x1e0 0x1e0 0x1e0 0x1e7 0x1ea 0x1e2 0x1e8 0x1e7 0x1e4 0x1e6 0x1e8 0x1e3 0x1db 0x1e7 0x1d8 0x1db 0x1d6 0x1d8 0x1d9 0x1db 0x1db 0x1e7 0x1de 0x1e7 0x1e7 0x1e8 0x1e4 0x1e4 0x1de 0x1d7 0x1e6 0x1e4 0x1e6 0x1df 0x1e7 0x1e6 0x1e7 0x1df 0x1e2 0x1e1 0x1de 0x1e0 0x1df 0x1e7 0x1de 0x1dd 0x1e9 0x1e4 0x1ea 0x1de 0x1e9 0x1e1 0x1e4 0x1df 0x1e4 0x1dd 0x1de 0x1da 0x1dd 0x1e6 0x1ed 0x1d2 0x1e6 0x1ea 0x1e6 0x1e4 0x1e7 0x1e9 0x1db 0x1e0 0x1e2 0x1de 0x1e1 0x1dc 0x1e0 0x1e1 0x1de 0x1e1 0x1e2 0x1e0 0x1de 0x1e3 0x1de 0x1e0 0x1de 0x1e0 0x1da 0x1df 0x1e4 0x1e0 0x1dc 0x1de 0x1dd 0x1db 0x1da 0x1e1 0x1e3 0x1e6 0x1e1 0x1e3 0x1db 0x1d9 0x1db 0x1ec 0x1d8 0x1e3 0x1e1 0x1d7 0x1db 0xf0 0xf0 0xf0>;
					PS_Config_Lmt_FW_CC_P = <0x29 0x2a 0x2a 0x2a 0x2a 0x2a 0x2a 0xffff 0xffff 0x2a 0x2c 0x2a 0x2a 0x2a 0x2a 0x2a 0x2a 0x2a 0x2a 0x2a 0x2a 0x2a 0x2a 0x2c 0x2a 0x2a 0x2a 0x2a 0x2a 0x2a 0x2a 0x2a 0x2a 0x29 0x29 0x2a 0x29 0x2a 0x2a 0x2a 0x2a 0x2a 0x2a 0x2a 0x2a 0x2a 0x2a 0x2a 0x2a 0x2a 0x2a 0x2a 0x2a 0x2a 0x2a 0x2c 0x2a 0x2a 0x2a 0x2a 0x2a 0x2a 0x2a 0x2c 0x2a 0x2a 0x2a 0x2a 0x2a 0x2a 0x2a 0x2a 0x2a 0x2a 0x2a 0x2a 0x2a 0x2a 0x2a 0x2a 0x2c 0x2a 0x2a 0x2a 0x2a 0x2a 0x2a 0x2c 0x2a 0x2a 0x2a 0x2a 0x2a 0x2a 0x2a 0x2a 0x2a 0x2a 0x2a 0x2a 0x2a 0x2a 0x2a 0x2a 0x2a 0x2a 0x2a 0x2a 0x2a 0x2a 0x2a 0x2a 0x2c 0x2a 0x2a 0x2a 0x2a 0x2a 0x2a 0x2c 0x2a 0x2a 0x2a 0x2a 0x2a 0x2a 0x2a 0x2c 0x2a 0x2a 0x2a 0x2a 0x2a 0x2a 0x2a 0x2a 0x2c 0x2a 0x2a 0x2a 0x2a 0x2a 0x2a 0x2c 0x2c 0x2a 0x2a 0x2a 0x2a 0x2c 0x2a 0x2c 0x2c 0x2a 0x2a 0x2a 0x2a 0x2a 0x2a 0x2c 0x2c 0x2a 0x2a 0x2a 0x2a 0x2c 0x2a 0x2c 0x2c 0x2c 0x2c 0x2c 0x2c 0x2a 0x2a 0x2c 0x2a 0x2a 0x2a 0x2a 0x2a 0x2c 0x2a 0x2c 0x2c 0x2c 0x2a 0x2a 0x2a 0x2a 0x2a 0x2c 0x2a 0x2a 0x2a 0x2a 0x2a 0x2a 0x2a 0x2a 0x2c 0x2c 0x2a 0x2a 0x2a 0x2a 0x2a 0x2c 0x2c 0x2a 0x2c 0x2c 0x2c 0x2c 0x2c 0x2c 0x2c 0x2c 0x2a 0x2a 0x2a 0x2a 0x2a 0x2c 0x2a 0x2a 0x2a 0x2a 0x2a 0x2a 0x2a 0x2a 0x2a 0x2c 0x2a 0x2a 0x2a 0x2a 0x2a 0x2c 0x2c 0x2a 0x2a 0x2c 0x2c 0x2c 0x2c 0x2d 0x2c 0x2c 0x2a 0x2a 0x2c 0x2a 0x2a 0x2c 0x2c 0x2a 0x2a 0x2a 0x2a 0x2c 0x2c 0x2c 0x2a 0x2c 0x2c 0x2a 0x2a 0x2a 0x2a 0x2c 0x2a 0x2a 0x2a 0x2a 0x2a 0x2c 0x2c 0x2c 0x2a 0x2c 0x2c 0x2a 0x2a 0x2a 0x2a 0x2c 0x2c 0x2a 0x2a 0x2a 0x2a 0x2a 0x2a 0x2a 0x2c 0x2a 0x2a 0x2a 0x2a 0x2a 0x2a 0x2c 0x2c 0x2a 0x2a 0x2a 0x2a 0x2c 0x2c 0x2c 0x2c 0x2c 0x2c 0x2a 0x2a 0x2a 0x2a 0x2c 0x2c 0x2a 0x2a 0x2a 0x2a 0x2a 0x2a 0x2a 0x2c 0x2c 0x2c 0x2a 0x2c 0x2a 0x2a 0x2c 0x2d 0x2c 0x2c 0x2c 0x2c 0x2c 0x2c 0x2c 0x2c 0x2c 0x2c 0x2a 0x2c 0x2a 0x2a 0x2c 0x2c 0x2a 0x2a 0x2a 0x2a 0x2a 0x2a 0x2a 0x2c 0x2a 0x2a 0x2a 0x2a 0x2a 0x2a 0x2c 0x2c 0x2a 0x2a 0x2a 0x2a 0x2a 0x2c 0x2c 0x2c 0x2a 0x2a 0x2a 0x2a 0x2a 0x2a 0x2c 0x2c 0x2a 0x2a 0x2a 0x2a 0x2a 0x2a 0x2a 0x2c 0x2c 0x2c 0x2c 0x2c 0x2c 0x2c 0x2c 0x2c 0x2c 0x2c 0x2c 0x2c 0x2c 0x2c 0x2c 0x2c 0x2c 0x2c 0x2c 0x2c 0x2c 0x2c 0x2c 0x2c 0x2a 0x2a 0x2a 0x2a 0x2a 0x2c 0x2c 0x2c 0x2c 0x2c 0x2c 0x2c 0x2c 0x2c 0x2c 0x2c 0x2a 0x2c 0x2c 0x2c 0x2c 0x2c 0x2c 0x2c 0x2c 0x2c 0x2c 0x2c 0x2c 0x2c 0x2c 0x2c 0x2a 0x2a 0x2a 0x2a 0x2a 0x2a 0x2a 0x2c 0x2c 0x2c 0x2c 0x2c 0x2c 0x2a 0x2c 0x2c 0x2c 0x2c 0x2c 0x2c 0x2c 0x2c 0x2c 0x2c 0x2c 0x2c 0x2c 0x2c 0x2c 0x2c 0x2c 0x2a 0x2a 0x2a 0x2a 0x2a 0x2a 0x2a 0x2a 0x2c 0x2c 0x2c 0x2c 0x2c 0x2c 0x2c 0x2d 0x2c 0x2c 0x2c 0x2c 0x2c 0x2c 0x2c 0x2c 0x2c 0x2c 0x2c 0x2c 0x2c 0x2c 0x2a 0x2c 0x2c 0x2a 0x2a 0x2a 0x2c 0x2a 0x2a 0x2a 0x2c 0x2c 0x2c 0x2c 0x2c 0x2c 0x2a 0x2c 0x2d 0x2c 0x2c 0x2c 0x2c 0x2c 0x2c 0x2c 0x2c 0x2c 0x2a 0x2a 0x2a 0x2c 0x2a 0x2c 0x2c 0x2a 0x2a 0x2a 0x2a 0x2a 0x2a 0x2a 0x2c 0x2c 0x2a 0x2a 0x2a 0x2c 0x2a 0x2c 0x2a 0x2a 0x2a 0x2c 0x2c 0x2c 0x2c 0x2c 0x2c 0x2c 0x2a 0x2c 0x2a 0x2a 0x2a 0x2a 0x13a 0x13a 0x13a>;
					PS_Config_Lmt_FW_CC_N = <0x12 0x13 0x13 0x13 0x13 0x13 0x13 0xffff0001 0xffff0001 0x13 0x13 0x13 0x13 0x13 0x13 0x13 0x13 0x13 0x13 0x13 0x13 0x13 0x13 0x13 0x13 0x13 0x13 0x13 0x13 0x13 0x13 0x13 0x13 0x12 0x12 0x13 0x12 0x13 0x13 0x13 0x13 0x13 0x13 0x13 0x13 0x13 0x13 0x13 0x13 0x13 0x13 0x13 0x13 0x13 0x13 0x13 0x13 0x13 0x13 0x13 0x13 0x13 0x13 0x13 0x13 0x13 0x13 0x13 0x13 0x13 0x13 0x13 0x13 0x13 0x13 0x13 0x13 0x13 0x13 0x13 0x13 0x13 0x13 0x13 0x13 0x13 0x13 0x13 0x13 0x13 0x13 0x13 0x13 0x13 0x13 0x13 0x13 0x13 0x13 0x13 0x13 0x13 0x13 0x13 0x13 0x13 0x13 0x13 0x13 0x13 0x13 0x13 0x13 0x13 0x13 0x13 0x13 0x13 0x13 0x13 0x13 0x13 0x13 0x13 0x13 0x13 0x13 0x13 0x13 0x13 0x13 0x13 0x13 0x13 0x13 0x13 0x13 0x13 0x13 0x13 0x13 0x13 0x13 0x13 0x13 0x13 0x13 0x13 0x13 0x13 0x13 0x13 0x13 0x13 0x13 0x13 0x13 0x13 0x13 0x13 0x13 0x13 0x13 0x13 0x13 0x13 0x13 0x13 0x13 0x13 0x13 0x13 0x13 0x13 0x13 0x13 0x13 0x13 0x13 0x13 0x13 0x13 0x13 0x13 0x13 0x13 0x13 0x13 0x13 0x13 0x13 0x13 0x13 0x13 0x13 0x13 0x13 0x13 0x13 0x13 0x13 0x13 0x13 0x13 0x13 0x13 0x13 0x13 0x13 0x13 0x13 0x13 0x13 0x13 0x13 0x13 0x13 0x13 0x13 0x13 0x13 0x13 0x13 0x13 0x13 0x13 0x13 0x13 0x13 0x13 0x13 0x13 0x13 0x13 0x13 0x13 0x13 0x13 0x13 0x13 0x13 0x13 0x13 0x13 0x13 0x13 0x13 0x14 0x13 0x13 0x13 0x13 0x13 0x13 0x13 0x13 0x13 0x13 0x13 0x13 0x13 0x13 0x13 0x13 0x13 0x13 0x13 0x13 0x13 0x13 0x13 0x13 0x13 0x13 0x13 0x13 0x13 0x13 0x13 0x13 0x13 0x13 0x13 0x13 0x13 0x13 0x13 0x13 0x13 0x13 0x13 0x13 0x13 0x13 0x13 0x13 0x13 0x13 0x13 0x13 0x13 0x13 0x13 0x13 0x13 0x13 0x13 0x13 0x13 0x13 0x13 0x13 0x13 0x13 0x13 0x13 0x13 0x13 0x13 0x13 0x13 0x13 0x13 0x13 0x13 0x13 0x13 0x13 0x13 0x13 0x13 0x13 0x13 0x13 0x13 0x13 0x14 0x13 0x13 0x13 0x13 0x13 0x13 0x13 0x13 0x13 0x13 0x13 0x13 0x13 0x13 0x13 0x13 0x13 0x13 0x13 0x13 0x13 0x13 0x13 0x13 0x13 0x13 0x13 0x13 0x13 0x13 0x13 0x13 0x13 0x13 0x13 0x13 0x13 0x13 0x13 0x13 0x13 0x13 0x13 0x13 0x13 0x13 0x13 0x13 0x13 0x13 0x13 0x13 0x13 0x13 0x13 0x13 0x13 0x13 0x13 0x13 0x13 0x13 0x13 0x13 0x13 0x13 0x13 0x13 0x13 0x13 0x13 0x13 0x13 0x13 0x13 0x13 0x13 0x13 0x13 0x13 0x13 0x13 0x13 0x13 0x13 0x13 0x13 0x13 0x13 0x13 0x13 0x13 0x13 0x13 0x13 0x13 0x13 0x13 0x13 0x13 0x13 0x13 0x13 0x13 0x13 0x13 0x13 0x13 0x13 0x13 0x13 0x13 0x13 0x13 0x13 0x13 0x13 0x13 0x13 0x13 0x13 0x13 0x13 0x13 0x13 0x13 0x13 0x13 0x13 0x13 0x13 0x13 0x13 0x13 0x13 0x13 0x13 0x13 0x13 0x13 0x13 0x13 0x13 0x13 0x13 0x13 0x13 0x13 0x13 0x13 0x13 0x13 0x13 0x13 0x13 0x13 0x13 0x13 0x14 0x13 0x13 0x13 0x13 0x13 0x13 0x13 0x13 0x13 0x13 0x13 0x13 0x13 0x13 0x13 0x13 0x13 0x13 0x13 0x13 0x13 0x13 0x13 0x13 0x13 0x13 0x13 0x13 0x13 0x13 0x13 0x13 0x14 0x13 0x13 0x13 0x13 0x13 0x13 0x13 0x13 0x13 0x13 0x13 0x13 0x13 0x13 0x13 0x13 0x13 0x13 0x13 0x13 0x13 0x13 0x13 0x13 0x13 0x13 0x13 0x13 0x13 0x13 0x13 0x13 0x13 0x13 0x13 0x13 0x13 0x13 0x13 0x13 0x13 0x13 0x13 0x13 0x13 0x13 0x13 0x00 0x00 0x00>;
					PS_Config_Lmt_FW_Diff_P = <0x32 0x32 0x32 0x32 0x32 0x32 0x32 0xffff 0xffff 0x32 0x32 0x32 0x32 0x32 0x32 0x32 0x32 0x32 0x32 0x32 0x32 0x32 0x32 0x32 0x32 0x32 0x32 0x32 0x32 0x32 0x32 0x32 0x32 0x32 0x32 0x32 0x32 0x32 0x32 0x32 0x32 0x32 0x32 0x32 0x32 0x32 0x32 0x32 0x32 0x32 0x32 0x32 0x32 0x32 0x32 0x32 0x32 0x32 0x32 0x32 0x32 0x32 0x32 0x32 0x32 0x32 0x32 0x32 0x32 0x32 0x32 0x32 0x32 0x32 0x32 0x32 0x32 0x32 0x32 0x32 0x32 0x32 0x32 0x32 0x32 0x32 0x32 0x32 0x32 0x32 0x32 0x32 0x32 0x32 0x32 0x32 0x32 0x32 0x32 0x32 0x32 0x32 0x32 0x32 0x32 0x32 0x32 0x32 0x32 0x32 0x32 0x32 0x32 0x32 0x32 0x32 0x32 0x32 0x32 0x32 0x32 0x32 0x32 0x32 0x32 0x32 0x32 0x32 0x32 0x32 0x32 0x32 0x32 0x32 0x32 0x32 0x32 0x32 0x32 0x32 0x32 0x32 0x32 0x32 0x32 0x32 0x32 0x32 0x32 0x32 0x32 0x32 0x32 0x32 0x32 0x32 0x32 0x32 0x32 0x32 0x32 0x32 0x32 0x32 0x32 0x32 0x32 0x32 0x32 0x32 0x32 0x32 0x32 0x32 0x32 0x32 0x32 0x32 0x32 0x32 0x32 0x32 0x32 0x32 0x32 0x32 0x32 0x32 0x32 0x32 0x32 0x32 0x32 0x32 0x32 0x32 0x32 0x32 0x32 0x32 0x32 0x32 0x32 0x32 0x32 0x32 0x32 0x32 0x32 0x32 0x32 0x32 0x32 0x32 0x32 0x32 0x32 0x32 0x32 0x32 0x32 0x32 0x32 0x32 0x32 0x32 0x32 0x32 0x32 0x32 0x32 0x32 0x32 0x32 0x32 0x32 0x32 0x32 0x32 0x32 0x32 0x32 0x32 0x32 0x32 0x32 0x32 0x32 0x32 0x32 0x32 0x32 0x32 0x32 0x32 0x32 0x32 0x32 0x32 0x32 0x32 0x32 0x32 0x32 0x32 0x32 0x32 0x32 0x32 0x32 0x32 0x32 0x32 0x32 0x32 0x32 0x32 0x32 0x32 0x32 0x32 0x32 0x32 0x32 0x32 0x32 0x32 0x32 0x32 0x32 0x32 0x32 0x32 0x32 0x32 0x32 0x32 0x32 0x32 0x32 0x32 0x32 0x32 0x32 0x32 0x32 0x32 0x32 0x32 0x32 0x32 0x32 0x32 0x32 0x32 0x32 0x32 0x32 0x32 0x32 0x32 0x32 0x32 0x32 0x32 0x32 0x32 0x32 0x32 0x32 0x32 0x32 0x32 0x32 0x32 0x32 0x32 0x32 0x32 0x32 0x32 0x32 0x32 0x32 0x32 0x32 0x32 0x32 0x32 0x32 0x32 0x32 0x32 0x32 0x32 0x32 0x32 0x32 0x32 0x32 0x32 0x32 0x32 0x32 0x32 0x32 0x32 0x32 0x32 0x32 0x32 0x32 0x32 0x32 0x32 0x32 0x32 0x32 0x32 0x32 0x32 0x32 0x32 0x32 0x32 0x32 0x32 0x32 0x32 0x32 0x32 0x32 0x32 0x32 0x32 0x32 0x32 0x32 0x32 0x32 0x32 0x32 0x32 0x32 0x32 0x32 0x32 0x32 0x32 0x32 0x32 0x32 0x32 0x32 0x32 0x32 0x32 0x32 0x32 0x32 0x32 0x32 0x32 0x32 0x32 0x32 0x32 0x32 0x32 0x32 0x32 0x32 0x32 0x32 0x32 0x32 0x32 0x32 0x32 0x32 0x32 0x32 0x32 0x32 0x32 0x32 0x32 0x32 0x32 0x32 0x32 0x32 0x32 0x32 0x32 0x32 0x32 0x32 0x32 0x32 0x32 0x32 0x32 0x32 0x32 0x32 0x32 0x32 0x32 0x32 0x32 0x32 0x32 0x32 0x32 0x32 0x32 0x32 0x32 0x32 0x32 0x32 0x32 0x32 0x32 0x32 0x32 0x32 0x32 0x32 0x32 0x32 0x32 0x32 0x32 0x32 0x32 0x32 0x32 0x32 0x32 0x32 0x32 0x32 0x32 0x32 0x32 0x32 0x32 0x32 0x32 0x32 0x32 0x32 0x32 0x32 0x32 0x32 0x32 0x32 0x32 0x32 0x32 0x32 0x32 0x32 0x32 0x32 0x32 0x32 0x32 0x32 0x32 0x32 0x32 0x32 0x32 0x32 0x32 0x32 0x32 0x32 0x32 0x32 0x32 0x32 0x32 0x32 0x32 0x32 0x32 0x32 0x32 0x32 0x32 0x32 0x32 0x32 0x32 0x32 0x32 0x32 0x32 0x32 0x32 0x32 0x32 0x32 0x32 0x32 0x32 0x32 0x32 0x32 0x32 0x32 0x4b 0x4b 0x4b>;
					PS_Config_Lmt_FW_Diff_N = <0xffffffce 0xffffffce 0xffffffce 0xffffffce 0xffffffce 0xffffffce 0xffffffce 0xffff0001 0xffff0001 0xffffffce 0xffffffce 0xffffffce 0xffffffce 0xffffffce 0xffffffce 0xffffffce 0xffffffce 0xffffffce 0xffffffce 0xffffffce 0xffffffce 0xffffffce 0xffffffce 0xffffffce 0xffffffce 0xffffffce 0xffffffce 0xffffffce 0xffffffce 0xffffffce 0xffffffce 0xffffffce 0xffffffce 0xffffffce 0xffffffce 0xffffffce 0xffffffce 0xffffffce 0xffffffce 0xffffffce 0xffffffce 0xffffffce 0xffffffce 0xffffffce 0xffffffce 0xffffffce 0xffffffce 0xffffffce 0xffffffce 0xffffffce 0xffffffce 0xffffffce 0xffffffce 0xffffffce 0xffffffce 0xffffffce 0xffffffce 0xffffffce 0xffffffce 0xffffffce 0xffffffce 0xffffffce 0xffffffce 0xffffffce 0xffffffce 0xffffffce 0xffffffce 0xffffffce 0xffffffce 0xffffffce 0xffffffce 0xffffffce 0xffffffce 0xffffffce 0xffffffce 0xffffffce 0xffffffce 0xffffffce 0xffffffce 0xffffffce 0xffffffce 0xffffffce 0xffffffce 0xffffffce 0xffffffce 0xffffffce 0xffffffce 0xffffffce 0xffffffce 0xffffffce 0xffffffce 0xffffffce 0xffffffce 0xffffffce 0xffffffce 0xffffffce 0xffffffce 0xffffffce 0xffffffce 0xffffffce 0xffffffce 0xffffffce 0xffffffce 0xffffffce 0xffffffce 0xffffffce 0xffffffce 0xffffffce 0xffffffce 0xffffffce 0xffffffce 0xffffffce 0xffffffce 0xffffffce 0xffffffce 0xffffffce 0xffffffce 0xffffffce 0xffffffce 0xffffffce 0xffffffce 0xffffffce 0xffffffce 0xffffffce 0xffffffce 0xffffffce 0xffffffce 0xffffffce 0xffffffce 0xffffffce 0xffffffce 0xffffffce 0xffffffce 0xffffffce 0xffffffce 0xffffffce 0xffffffce 0xffffffce 0xffffffce 0xffffffce 0xffffffce 0xffffffce 0xffffffce 0xffffffce 0xffffffce 0xffffffce 0xffffffce 0xffffffce 0xffffffce 0xffffffce 0xffffffce 0xffffffce 0xffffffce 0xffffffce 0xffffffce 0xffffffce 0xffffffce 0xffffffce 0xffffffce 0xffffffce 0xffffffce 0xffffffce 0xffffffce 0xffffffce 0xffffffce 0xffffffce 0xffffffce 0xffffffce 0xffffffce 0xffffffce 0xffffffce 0xffffffce 0xffffffce 0xffffffce 0xffffffce 0xffffffce 0xffffffce 0xffffffce 0xffffffce 0xffffffce 0xffffffce 0xffffffce 0xffffffce 0xffffffce 0xffffffce 0xffffffce 0xffffffce 0xffffffce 0xffffffce 0xffffffce 0xffffffce 0xffffffce 0xffffffce 0xffffffce 0xffffffce 0xffffffce 0xffffffce 0xffffffce 0xffffffce 0xffffffce 0xffffffce 0xffffffce 0xffffffce 0xffffffce 0xffffffce 0xffffffce 0xffffffce 0xffffffce 0xffffffce 0xffffffce 0xffffffce 0xffffffce 0xffffffce 0xffffffce 0xffffffce 0xffffffce 0xffffffce 0xffffffce 0xffffffce 0xffffffce 0xffffffce 0xffffffce 0xffffffce 0xffffffce 0xffffffce 0xffffffce 0xffffffce 0xffffffce 0xffffffce 0xffffffce 0xffffffce 0xffffffce 0xffffffce 0xffffffce 0xffffffce 0xffffffce 0xffffffce 0xffffffce 0xffffffce 0xffffffce 0xffffffce 0xffffffce 0xffffffce 0xffffffce 0xffffffce 0xffffffce 0xffffffce 0xffffffce 0xffffffce 0xffffffce 0xffffffce 0xffffffce 0xffffffce 0xffffffce 0xffffffce 0xffffffce 0xffffffce 0xffffffce 0xffffffce 0xffffffce 0xffffffce 0xffffffce 0xffffffce 0xffffffce 0xffffffce 0xffffffce 0xffffffce 0xffffffce 0xffffffce 0xffffffce 0xffffffce 0xffffffce 0xffffffce 0xffffffce 0xffffffce 0xffffffce 0xffffffce 0xffffffce 0xffffffce 0xffffffce 0xffffffce 0xffffffce 0xffffffce 0xffffffce 0xffffffce 0xffffffce 0xffffffce 0xffffffce 0xffffffce 0xffffffce 0xffffffce 0xffffffce 0xffffffce 0xffffffce 0xffffffce 0xffffffce 0xffffffce 0xffffffce 0xffffffce 0xffffffce 0xffffffce 0xffffffce 0xffffffce 0xffffffce 0xffffffce 0xffffffce 0xffffffce 0xffffffce 0xffffffce 0xffffffce 0xffffffce 0xffffffce 0xffffffce 0xffffffce 0xffffffce 0xffffffce 0xffffffce 0xffffffce 0xffffffce 0xffffffce 0xffffffce 0xffffffce 0xffffffce 0xffffffce 0xffffffce 0xffffffce 0xffffffce 0xffffffce 0xffffffce 0xffffffce 0xffffffce 0xffffffce 0xffffffce 0xffffffce 0xffffffce 0xffffffce 0xffffffce 0xffffffce 0xffffffce 0xffffffce 0xffffffce 0xffffffce 0xffffffce 0xffffffce 0xffffffce 0xffffffce 0xffffffce 0xffffffce 0xffffffce 0xffffffce 0xffffffce 0xffffffce 0xffffffce 0xffffffce 0xffffffce 0xffffffce 0xffffffce 0xffffffce 0xffffffce 0xffffffce 0xffffffce 0xffffffce 0xffffffce 0xffffffce 0xffffffce 0xffffffce 0xffffffce 0xffffffce 0xffffffce 0xffffffce 0xffffffce 0xffffffce 0xffffffce 0xffffffce 0xffffffce 0xffffffce 0xffffffce 0xffffffce 0xffffffce 0xffffffce 0xffffffce 0xffffffce 0xffffffce 0xffffffce 0xffffffce 0xffffffce 0xffffffce 0xffffffce 0xffffffce 0xffffffce 0xffffffce 0xffffffce 0xffffffce 0xffffffce 0xffffffce 0xffffffce 0xffffffce 0xffffffce 0xffffffce 0xffffffce 0xffffffce 0xffffffce 0xffffffce 0xffffffce 0xffffffce 0xffffffce 0xffffffce 0xffffffce 0xffffffce 0xffffffce 0xffffffce 0xffffffce 0xffffffce 0xffffffce 0xffffffce 0xffffffce 0xffffffce 0xffffffce 0xffffffce 0xffffffce 0xffffffce 0xffffffce 0xffffffce 0xffffffce 0xffffffce 0xffffffce 0xffffffce 0xffffffce 0xffffffce 0xffffffce 0xffffffce 0xffffffce 0xffffffce 0xffffffce 0xffffffce 0xffffffce 0xffffffce 0xffffffce 0xffffffce 0xffffffce 0xffffffce 0xffffffce 0xffffffce 0xffffffce 0xffffffce 0xffffffce 0xffffffce 0xffffffce 0xffffffce 0xffffffce 0xffffffce 0xffffffce 0xffffffce 0xffffffce 0xffffffce 0xffffffce 0xffffffce 0xffffffce 0xffffffce 0xffffffce 0xffffffce 0xffffffce 0xffffffce 0xffffffce 0xffffffce 0xffffffce 0xffffffce 0xffffffce 0xffffffce 0xffffffce 0xffffffce 0xffffffce 0xffffffce 0xffffffce 0xffffffce 0xffffffce 0xffffffce 0xffffffce 0xffffffce 0xffffffce 0xffffffce 0xffffffce 0xffffffce 0xffffffce 0xffffffce 0xffffffce 0xffffffce 0xffffffce 0xffffffce 0xffffffce 0xffffffce 0xffffffce 0xffffffce 0xffffffce 0xffffffce 0xffffffce 0xffffffce 0xffffffce 0xffffffce 0xffffffce 0xffffffce 0xffffffce 0xffffffce 0xffffffce 0xffffffce 0xffffffce 0xffffffce 0xffffffce 0xffffffce 0xffffffce 0xffffffce 0xffffffce 0xffffffce 0xffffffce 0xffffffce 0xffffffce 0xffffffce 0xffffffce 0xffffffce 0xffffffce 0xffffffce 0xffffffce 0xffffffce 0xffffffce 0xffffffce 0xffffffce 0xffffffce 0xffffffce 0xffffffce 0xffffffce 0xffffffce 0xffffffce 0xffffffce 0xffffffce 0xffffffce 0xffffffce 0xffffffce 0xffffffce 0xffffffce 0xffffffce 0xffffffce 0xffffffce 0xffffffce 0xffffffce 0xffffffce 0xffffffce 0xffffffce 0xffffffce 0xffffffce 0xffffffce 0xffffffce 0xffffffce 0xffffffce 0xffffffce 0xffffffce 0xffffffce 0xffffffce 0xffffffce 0xffffffce 0xffffffce 0xffffffce 0xffffffce 0xffffffce 0xffffffce 0xffffffce 0xffffffce 0xffffffce 0xffffffce 0xffffffce 0xffffffce 0xffffffce 0xffffffce 0xffffffce 0xffffffce 0xffffffce 0xffffffce 0xffffffb5 0xffffffb5 0xffffffb5>;
					PS_Config_Diff_Test_Frame = <0x32>;
				};
			};
		};
	};

	fragment@24 {
		target = <0xffffffff>;

		__overlay__ {

			lm3643@63 {
				compatible = "mediatek,lm3643";
				reg = <0x63>;
				#cooling-cells = <0x02>;
				pinctrl-names = "default\0hwen_high\0hwen_low";
				pinctrl-0 = <0x3a>;
				pinctrl-1 = <0x3b>;
				pinctrl-2 = <0x3c>;
				status = "okay";
				phandle = <0x56>;

				flash@0 {
					reg = <0x00>;
					type = <0x00>;
					ct = <0x00>;
					part = <0x00>;

					port@0 {

						endpoint {
							remote-endpoint = <0x3d>;
							phandle = <0x3f>;
						};
					};
				};

				flash@1 {
					reg = <0x01>;
					type = <0x00>;
					ct = <0x01>;
					part = <0x00>;

					port@1 {

						endpoint {
							remote-endpoint = <0x3e>;
							phandle = <0x40>;
						};
					};
				};
			};
		};
	};

	fragment@25 {
		target = <0xffffffff>;

		__overlay__ {

			default {
				phandle = <0x3a>;
			};

			hwen_high {
				phandle = <0x3b>;

				pins_cmd_dat {
					pinmux = <0x9d00>;
					slew-rate = <0x01>;
					output-high;
				};
			};

			hwen_low {
				phandle = <0x3c>;

				pins_cmd_dat {
					pinmux = <0x9d00>;
					slew-rate = <0x01>;
					output-low;
				};
			};
		};
	};

	fragment@26 {
		target = <0xffffffff>;

		__overlay__ {

			port@0 {

				endpoint {
					remote-endpoint = <0x3f>;
					phandle = <0x3d>;
				};
			};

			port@1 {

				endpoint {
					remote-endpoint = <0x40>;
					phandle = <0x3e>;
				};
			};
		};
	};

	fragment@27 {
		target = <0xffffffff>;

		__overlay__ {

			nxp@28 {
				compatible = "nq-nci";
				reg = <0x28>;
				nq-irq = <0xffffffff 0x01 0x00>;
				interrupt-parent = <0xffffffff>;
				interrupts = <0x01 0x04 0x01 0x00>;
				nq-ven = <0xffffffff 0x96 0x00>;
				nq-firm = <0xffffffff 0x25 0x00>;
				nq-clkreq = <0xffffffff 0x44 0x00>;
				interrupt-names = "irq_nfc";
				status = "okay";
			};
		};
	};

	fragment@28 {
		target = <0xffffffff>;

		__overlay__ {

			speaker_amp@5c {
				compatible = "richtek,rt5512";
				#sound-dai-cells = <0x00>;
				reg = <0x5c>;
				status = "disabled";
				sound-name-prefix = "Left";
				phandle = <0x41>;
			};

			aw87xxx_pa@58 {
				compatible = "awinic,aw87xxx_pa";
				reg = <0x58>;
				dev_index = <0x00>;
				status = "okay";
			};

			i2c_lcd_bias@3e {
				compatible = "mediatek,i2c_lcd_bias";
				reg = <0x3e>;
				id = <0x06>;
				status = "okay";
			};

			lm3697@36 {
				compatible = "ti,lm3697";
				reg = <0x36>;
				status = "okay";
				enable-gpios = <0xffffffff 0x0c 0x00>;

				backlight {
					compatible = "ti,lm3697-backlight";

					lcd {
						led-sources = <0x00 0x01 0x02>;
						ramp-up-msec = <0xc8>;
						ramp-down-msec = <0xc8>;
						pwm-period = <0x00>;
						default-brightness-level = <0xff>;
					};
				};

				fault-monitor {
					compatible = "ti,lm3697-fault-monitor";
				};
			};

			ktd@37 {
				compatible = "ktd,ktd3137";
				reg = <0x37>;
				status = "okay";
				ktd,using-lsb = <0x01>;
				ktd,pwm-frequency = <0x64>;
				ktd,bl-fscal-led = <0x98>;
				ktd,turn-on-ramp = <0x00>;
				ktd,turn-off-ramp = <0x00>;
				ktd,pwm-trans-dim = <0x00>;
				ktd,i2c-trans-dim = <0x00>;
				ktd,bl-channel = <0x02>;
				ktd,ovp-level = <0x20>;
				ktd,switching-frequency = <0x3e8>;
				ktd,inductor-current = <0xa28>;
			};
		};
	};

	fragment@29 {
		target = <0xffffffff>;

		__overlay__ {
			mediatek,pad-select = <0x00 0x01>;
		};
	};

	fragment@30 {
		target = <0xffffffff>;

		__overlay__ {
			clock-frequency = <0x61a80>;

			wusb3801@60 {
				compatible = "will,wusb3801";
				reg = <0x60>;
				interrupt-parent = <0xffffffff>;
				interrupts = <0x1a 0x00>;
				wusb3801,irq-gpio = <0xffffffff 0x1a 0x00>;
				interrupt-name = "wusb3801_int_irq";
				wusb3801,init-mode = <0x20>;
				wusb3801,host-current = <0x01>;
				wusb3801,drp-toggle-time = <0x00>;
				status = "okay";
			};

			fusb303@21 {
				status = "okay";
				compatible = "on,fusb303";
				reg = <0x21>;
				interrupt-parent = <0xffffffff>;
				interrupts = <0x1a 0x02>;
				fusb303,int-gpio = <0xffffffff 0x1a 0x00>;
				fusb303,init-mode = <0x14>;
				fusb303,host-current = <0x02>;
				fusb303,drp-toggle-time = <0x01>;
				fusb303,drp-duty-time = <0x00>;
				fusb303,autosink-threshold = <0x01>;
				fusb303,cc-debounce-time = <0x03>;
			};

			type_c_port0 {
				mt-tcpc,name = "type_c_port0";
				mt-tcpc,role_def = <0x05>;
				mt-tcpc,rp_level = <0x00>;
				mt-tcpc,vconn_supply = <0x01>;
				mt-tcpc,notifier_supply_num = <0x03>;
				mt6370pd,intr_gpio = <0xffffffff 0x1a 0x00>;
				mt6370pd,intr_gpio_num = <0x1a>;
			};
		};
	};

	fragment@31 {
		target = <0xffffffff>;

		__overlay__ {
			mediatek,spk-i2s = <0x03 0x00>;

			mediatek,speaker-codec {
				sound-dai = <0x41>;
			};
		};
	};

	fragment@32 {
		target = <0xffffffff>;

		__overlay__ {
			cd-gpios = <0xffffffff 0x07 0x00>;
		};
	};

	fragment@33 {
		target = <0xffffffff>;

		__overlay__ {
			microtrust,real-drv = <0x01>;
		};
	};

	fragment@34 {
		target = <0xffffffff>;

		__overlay__ {
		};
	};

	fragment@35 {
		target = <0xffffffff>;

		__overlay__ {
			mediatek,eye-vrt = <0x07>;
			mediatek,eye-term = <0x06>;
			mediatek,rev6 = <0x03>;
			mediatek,discth = <0x0f>;
		};
	};

	fragment@36 {
		target = <0xffffffff>;

		__overlay__ {
			ac_charger_current = <0x1b7740>;
			ac_charger_input_current = <0x1b7740>;
			non_std_ac_charger_current = <0xf4240>;
			boot_battery_voltage = <0x36ee80>;
			temp_t6_threshold = <0x37>;
			temp_t5_threshold = <0x2d>;
			temp_t4_threshold = <0x0f>;
			temp_t3_threshold = <0x0a>;
			temp_t2_threshold = <0x05>;
			temp_t1_threshold = <0x00>;
		};
	};

	fragment@37 {
		target = <0xffffffff>;

		__overlay__ {
			charger = <0xffffffff>;
			battery_cv = <0x43e6d0>;
			max_charger_voltage = <0xdd40a0>;
			min_charger_voltage = "\0I>";
			enable_sw_jeita;
			jeita_temp_above_t5_cv = <0x3e8fa0>;
			jeita_temp_t4_to_t5_cv = <0x3e8fa0>;
			jeita_temp_t3_to_t4_cv = <0x43e6d0>;
			jeita_temp_t2_to_t3_cv = <0x43e6d0>;
			jeita_temp_t1_to_t2_cv = <0x43e6d0>;
			jeita_temp_t0_to_t1_cv = <0x43e6d0>;
			jeita_temp_below_t0_cv = <0x43e6d0>;
			jeita_temp_t4_to_t5_cc = <0x249f00>;
			jeita_temp_t3_to_t4_cc = <0x2dc6c0>;
			jeita_temp_t2_to_t3_cc = <0x166e30>;
			jeita_temp_t1_to_t2_cc = "\0\aS";
			jeita_temp_t0_to_t1_cc = "\0\aS";
			jeita_temp_below_t0_cc = "\0\aS";
			temp_t5_thres = <0x37>;
			temp_t5_thres_minus_x_degree = <0x37>;
			temp_t4_thres = <0x2d>;
			temp_t4_thres_plus_x_degree = <0x2d>;
			temp_t3_thres = <0x0f>;
			temp_t3_thres_plus_x_degree = <0x0f>;
			temp_t2_thres = <0x0a>;
			temp_t2_thres_plus_x_degree = <0x0a>;
			temp_t1_thres = <0x05>;
			temp_t1_thres_plus_x_degree = <0x05>;
			min_charge_temp_plus_x_degree = <0x03>;
			max_charge_temp = <0x37>;
			ac_charger_input_current = <0x1f47d0>;
			non_std_ac_charger_current = <0xf4240>;
			recharger_uisoc_limit = <0x63>;
			enable_sw_ffc;
			ffc_cv_1 = <0x43df00>;
			ffc_cv_2 = <0x43a080>;
			ffc_cv_3 = "\0Cb";
			chg_cycle_count_level1 = <0x01>;
			chg_cycle_count_level2 = <0x64>;
			chg_cycle_count_level3 = <0x12c>;
		};
	};

	fragment@38 {
		target = <0xffffffff>;

		__overlay__ {
			status = "disable";
		};
	};

	fragment@39 {
		target = <0xffffffff>;

		__overlay__ {
			charger = <0xffffffff>;
		};
	};

	fragment@40 {
		target = <0xffffffff>;

		__overlay__ {
			swtp-gpio = <0xffffffff 0x5c 0x00>;
		};
	};

	fragment@41 {
		target = <0xffffffff>;

		__overlay__ {
			status = "ok";
			#address-cells = <0x01>;
			#size-cells = <0x00>;

			fpc_tee@0 {
				compatible = "goodix,goodix-fp";
				reg = <0x00>;
				fpc,enable-wakeup;
				spi-max-frequency = <0x989680>;
				netlink-event = <0x1e>;
				status = "okay";
			};
		};
	};

	fragment@42 {
		target = <0xffffffff>;

		__overlay__ {
			fpc,gpio_irq = <0xffffffff 0x00 0x00>;
			pinctrl-names = "default\0reset_high\0reset_low\0spi_mode\0avdd_en_high\0avdd_en_low";
			pinctrl-0 = <0x42>;
			pinctrl-1 = <0x43>;
			pinctrl-2 = <0x44>;
			pinctrl-3 = <0x45>;
			pinctrl-4 = <0x46>;
			pinctrl-5 = <0x47>;
			status = "okay";
		};
	};

	fragment@43 {
		target = <0xffffffff>;

		__overlay__ {

			state_default {
				phandle = <0x42>;

				pins_cmd_dat {
					pinmux = <0x00>;
					slew-rate = <0x00>;
					bias-disable;
				};
			};

			state_reset_high {
				phandle = <0x43>;

				pins_cmd_dat {
					pinmux = <0x6c00>;
					slew-rate = <0x01>;
					output-high;
				};
			};

			state_reset_low {
				phandle = <0x44>;

				pins_cmd_dat {
					pinmux = <0x6c00>;
					slew-rate = <0x01>;
					output-low;
				};
			};

			spi_mode {
				phandle = <0x45>;

				pins_cmd_dat {
					pinmux = <0x2a01 0x2b01 0x2c01 0x2d01>;
					drive-strength = <0x02>;
				};
			};

			state_avdd_high {
				phandle = <0x46>;

				pins_cmd_dat {
					pinmux = <0x6a00>;
					slew-rate = <0x01>;
					output-high;
				};
			};

			state_avdd_low {
				phandle = <0x47>;

				pins_cmd_dat {
					pinmux = <0x6a00>;
					slew-rate = <0x01>;
					output-low;
				};
			};
		};
	};

	fragment@44 {
		target = <0xffffffff>;

		__overlay__ {
			GPIO_SIM1_HOT_PLUG = <0xffffffff 0x17 0x00>;
			GPIO_SIM2_HOT_PLUG = <0xffffffff 0x18 0x00>;
			GPIO_SIM1_SCLK = <0xffffffff 0x4d 0x00>;
			GPIO_SIM1_SRST = <0xffffffff 0x4e 0x00>;
			GPIO_SIM1_SIO = <0xffffffff 0x4f 0x00>;
			GPIO_SIM2_SCLK = <0xffffffff 0x50 0x00>;
			GPIO_SIM2_SRST = <0xffffffff 0x51 0x00>;
			GPIO_SIM2_SIO = <0xffffffff 0x52 0x00>;
			GPIO_FDD_BAND_SUPPORT_DETECT_2ND_PIN = <0xffffffff 0x64 0x00>;
			GPIO_FDD_BAND_SUPPORT_DETECT_1ST_PIN = <0xffffffff 0x65 0x00>;
			GPIO_FDD_BAND_SUPPORT_DETECT_3RD_PIN = <0xffffffff 0x6f 0x00>;
		};
	};

	fragment@45 {
		target = <0xffffffff>;

		__overlay__ {
			gpio_init_default = <0x00 0x00 0x00 0x00 0x01 0x00 0x01 0x01 0x00 0x00 0x00 0x01 0x00 0x01 0x02 0x00 0x00 0x00 0x01 0x00 0x01 0x03 0x00 0x01 0x00 0x01 0x00 0x01 0x04 0x00 0x00 0x00 0x01 0x01 0x01 0x05 0x00 0x00 0x00 0x01 0x01 0x01 0x06 0x00 0x00 0x00 0x01 0x01 0x01 0x07 0x00 0x00 0x00 0x01 0x01 0x01 0x08 0x00 0x00 0x00 0x01 0x00 0x01 0x09 0x00 0x00 0x00 0x01 0x01 0x01 0x0a 0x00 0x00 0x00 0x01 0x00 0x01 0x0b 0x00 0x00 0x00 0x01 0x01 0x01 0x0c 0x00 0x01 0x01 0x01 0x00 0x01 0x0d 0x06 0x00 0x00 0x01 0x00 0x01 0x0e 0x06 0x00 0x00 0x01 0x00 0x00 0x0f 0x00 0x01 0x00 0x01 0x00 0x00 0x10 0x00 0x01 0x00 0x01 0x00 0x00 0x11 0x00 0x00 0x00 0x01 0x00 0x00 0x12 0x00 0x01 0x00 0x01 0x00 0x00 0x13 0x00 0x01 0x00 0x01 0x00 0x00 0x14 0x00 0x01 0x00 0x01 0x00 0x00 0x15 0x00 0x01 0x00 0x01 0x00 0x00 0x16 0x00 0x01 0x00 0x01 0x00 0x00 0x17 0x01 0x00 0x00 0x01 0x01 0x00 0x18 0x01 0x00 0x00 0x01 0x01 0x00 0x19 0x02 0x00 0x00 0x01 0x00 0x01 0x1a 0x03 0x00 0x00 0x01 0x01 0x01 0x1b 0x01 0x00 0x00 0x01 0x00 0x01 0x1c 0x01 0x00 0x00 0x01 0x01 0x01 0x1d 0x01 0x00 0x00 0x00 0x00 0x01 0x1e 0x01 0x00 0x00 0x00 0x00 0x01 0x1f 0x01 0x00 0x00 0x00 0x00 0x01 0x20 0x01 0x00 0x00 0x00 0x00 0x01 0x21 0x01 0x00 0x00 0x01 0x01 0x01 0x22 0x06 0x00 0x00 0x01 0x00 0x00 0x23 0x06 0x00 0x00 0x01 0x00 0x00 0x24 0x06 0x00 0x00 0x00 0x00 0x00 0x25 0x06 0x00 0x00 0x01 0x00 0x00 0x26 0x02 0x00 0x00 0x00 0x00 0x01 0x27 0x02 0x00 0x00 0x00 0x00 0x01 0x28 0x02 0x00 0x00 0x00 0x00 0x01 0x29 0x02 0x00 0x00 0x01 0x00 0x01 0x2a 0x01 0x00 0x00 0x00 0x00 0x01 0x2b 0x01 0x00 0x00 0x00 0x00 0x01 0x2c 0x01 0x00 0x00 0x00 0x00 0x01 0x2d 0x01 0x00 0x00 0x01 0x01 0x01 0x2e 0x04 0x00 0x00 0x01 0x00 0x00 0x2f 0x04 0x00 0x00 0x01 0x00 0x00 0x30 0x04 0x00 0x00 0x00 0x00 0x00 0x31 0x04 0x00 0x00 0x01 0x00 0x00 0x32 0x02 0x00 0x00 0x00 0x00 0x01 0x33 0x02 0x00 0x00 0x00 0x00 0x01 0x34 0x02 0x00 0x00 0x00 0x00 0x01 0x35 0x02 0x00 0x00 0x01 0x00 0x01 0x36 0x00 0x00 0x00 0x01 0x00 0x00 0x37 0x00 0x00 0x00 0x01 0x00 0x00 0x38 0x00 0x00 0x00 0x01 0x00 0x00 0x39 0x00 0x00 0x00 0x01 0x00 0x00 0x3a 0x00 0x00 0x00 0x01 0x00 0x00 0x3b 0x00 0x00 0x00 0x01 0x00 0x00 0x3c 0x00 0x00 0x00 0x01 0x00 0x00 0x3d 0x00 0x00 0x00 0x01 0x00 0x00 0x3e 0x00 0x00 0x00 0x01 0x00 0x00 0x3f 0x00 0x00 0x00 0x01 0x00 0x00 0x40 0x00 0x00 0x00 0x01 0x00 0x00 0x41 0x00 0x00 0x00 0x01 0x00 0x00 0x42 0x01 0x00 0x00 0x01 0x01 0x00 0x43 0x00 0x00 0x00 0x01 0x00 0x01 0x44 0x05 0x00 0x00 0x01 0x00 0x01 0x45 0x00 0x00 0x00 0x01 0x00 0x01 0x4d 0x01 0x00 0x00 0x00 0x00 0x01 0x4e 0x01 0x00 0x00 0x00 0x00 0x01 0x4f 0x01 0x00 0x00 0x01 0x01 0x01 0x50 0x01 0x00 0x00 0x00 0x00 0x01 0x51 0x01 0x00 0x00 0x00 0x00 0x01 0x52 0x01 0x00 0x00 0x01 0x01 0x01 0x53 0x01 0x00 0x00 0x01 0x00 0x01 0x54 0x01 0x00 0x00 0x00 0x00 0x01 0x55 0x00 0x01 0x00 0x00 0x00 0x01 0x56 0x01 0x00 0x00 0x01 0x00 0x00 0x57 0x01 0x00 0x00 0x01 0x00 0x00 0x58 0x01 0x00 0x00 0x01 0x00 0x00 0x59 0x01 0x00 0x00 0x01 0x00 0x00 0x5a 0x01 0x00 0x00 0x01 0x00 0x00 0x5b 0x01 0x00 0x00 0x01 0x00 0x00 0x5c 0x00 0x00 0x00 0x00 0x00 0x01 0x5d 0x01 0x00 0x00 0x01 0x00 0x00 0x5e 0x01 0x00 0x00 0x01 0x00 0x00 0x5f 0x03 0x00 0x00 0x01 0x00 0x00 0x60 0x01 0x00 0x00 0x01 0x00 0x00 0x61 0x01 0x00 0x00 0x01 0x00 0x00 0x62 0x01 0x00 0x00 0x01 0x00 0x00 0x63 0x01 0x00 0x00 0x01 0x00 0x00 0x64 0x00 0x00 0x00 0x00 0x00 0x00 0x65 0x00 0x00 0x00 0x00 0x00 0x00 0x66 0x01 0x00 0x00 0x01 0x00 0x00 0x67 0x02 0x00 0x00 0x01 0x00 0x00 0x68 0x02 0x00 0x00 0x00 0x00 0x00 0x69 0x01 0x00 0x00 0x01 0x00 0x00 0x6a 0x00 0x00 0x00 0x01 0x00 0x00 0x6b 0x00 0x01 0x00 0x01 0x00 0x00 0x6c 0x00 0x01 0x00 0x01 0x00 0x00 0x6d 0x01 0x00 0x00 0x01 0x00 0x00 0x6e 0x01 0x00 0x00 0x01 0x00 0x00 0x6f 0x00 0x00 0x00 0x00 0x00 0x00 0x70 0x01 0x00 0x00 0x00 0x00 0x00 0x71 0x01 0x00 0x00 0x01 0x00 0x00 0x72 0x01 0x00 0x00 0x00 0x00 0x00 0x73 0x01 0x00 0x00 0x01 0x00 0x00 0x74 0x01 0x00 0x00 0x00 0x00 0x00 0x75 0x01 0x00 0x00 0x01 0x00 0x00 0x76 0x01 0x00 0x00 0x00 0x00 0x00 0x77 0x01 0x00 0x00 0x01 0x00 0x00 0x78 0x01 0x00 0x00 0x00 0x00 0x00 0x79 0x01 0x00 0x00 0x01 0x00 0x00 0x7a 0x01 0x00 0x00 0x00 0x00 0x00 0x7b 0x01 0x00 0x00 0x00 0x00 0x00 0x7c 0x01 0x00 0x00 0x01 0x00 0x00 0x7d 0x01 0x00 0x00 0x01 0x00 0x00 0x7e 0x01 0x00 0x00 0x01 0x00 0x00 0x7f 0x01 0x00 0x00 0x01 0x00 0x00 0x80 0x01 0x00 0x00 0x01 0x00 0x00 0x81 0x01 0x00 0x00 0x01 0x00 0x00 0x82 0x02 0x00 0x00 0x01 0x01 0x01 0x83 0x02 0x00 0x00 0x01 0x01 0x01 0x84 0x02 0x00 0x00 0x01 0x01 0x00 0x85 0x02 0x00 0x00 0x01 0x01 0x00 0x86 0x01 0x00 0x00 0x01 0x01 0x01 0x87 0x01 0x00 0x00 0x01 0x01 0x01 0x88 0x01 0x00 0x00 0x01 0x01 0x01 0x89 0x01 0x00 0x00 0x01 0x01 0x01 0x8a 0x01 0x00 0x00 0x01 0x01 0x01 0x8b 0x01 0x00 0x00 0x01 0x01 0x01 0x8c 0x01 0x00 0x00 0x01 0x01 0x01 0x8d 0x01 0x00 0x00 0x01 0x01 0x01 0x8e 0x01 0x00 0x00 0x01 0x01 0x01 0x8f 0x01 0x00 0x00 0x01 0x01 0x01 0x90 0x01 0x00 0x00 0x01 0x01 0x01 0x91 0x01 0x00 0x00 0x01 0x01 0x01 0x92 0x01 0x00 0x00 0x01 0x01 0x01 0x93 0x01 0x00 0x00 0x01 0x01 0x01 0x94 0x01 0x00 0x00 0x01 0x01 0x01 0x95 0x01 0x00 0x00 0x01 0x01 0x01 0x96 0x00 0x01 0x00 0x01 0x00 0x01 0x97 0x00 0x01 0x00 0x00 0x00 0x01 0x98 0x00 0x01 0x01 0x01 0x00 0x01 0x99 0x00 0x01 0x00 0x01 0x00 0x01 0x9a 0x00 0x01 0x00 0x01 0x00 0x01 0x9b 0x00 0x01 0x00 0x01 0x00 0x01 0x9c 0x00 0x01 0x01 0x01 0x00 0x01 0x9d 0x00 0x01 0x00 0x01 0x00 0x01 0x9e 0x06 0x00 0x00 0x01 0x00 0x00 0x9f 0x00 0x00 0x00 0x01 0x00 0x00 0xa0 0x01 0x00 0x00 0x00 0x00 0x01 0xa1 0x01 0x00 0x00 0x00 0x00 0x01 0xa2 0x01 0x00 0x00 0x00 0x00 0x01 0xa3 0x01 0x00 0x00 0x01 0x00 0x01 0xa4 0x01 0x00 0x00 0x00 0x00 0x01 0xa5 0x01 0x00 0x00 0x00 0x00 0x01 0xa6 0x01 0x00 0x00 0x00 0x00 0x01 0xa7 0x01 0x00 0x00 0x01 0x00 0x01 0xa8 0x01 0x00 0x00 0x00 0x00 0x00 0xa9 0x01 0x00 0x00 0x00 0x00 0x01 0xaa 0x01 0x00 0x00 0x00 0x00 0x01 0xab 0x01 0x00 0x00 0x00 0x00 0x01 0xac 0x01 0x00 0x00 0x00 0x00 0x01 0xad 0x01 0x00 0x00 0x01 0x00 0x01 0xae 0x01 0x00 0x00 0x01 0x00 0x01 0xaf 0x01 0x00 0x00 0x01 0x00 0x01 0xb0 0x01 0x00 0x00 0x01 0x00 0x01 0xb1 0x01 0x00 0x00 0x01 0x00 0x00 0xb2 0x01 0x00 0x00 0x01 0x00 0x00 0xb3 0x01 0x00 0x00 0x01 0x00 0x00 0xb4 0x01 0x00 0x00 0x01 0x00 0x00 0xb5 0x01 0x00 0x00 0x01 0x00 0x00 0xb6 0x01 0x00 0x00 0x01 0x00 0x00 0xb7 0x01 0x00 0x00 0x01 0x00 0x00 0xb8 0x01 0x00 0x00 0x01 0x00 0x00 0xb9 0x01 0x00 0x00 0x01 0x00 0x00 0xba 0x01 0x00 0x00 0x01 0x01 0x01 0xbb 0x01 0x00 0x00 0x01 0x01 0x01 0xbc 0x00 0x00 0x00 0x01 0x00 0x00 0xbd 0x00 0x00 0x00 0x01 0x00 0x00 0xbe 0x00 0x00 0x00 0x01 0x00 0x00 0xbf 0x00 0x00 0x00 0x01 0x00 0x00 0xc0 0x00 0x00 0x00 0x01 0x00 0x00 0xc1 0x00 0x00 0x00 0x01 0x00 0x00 0xc2 0x00 0x00 0x00 0x01 0x00 0x00 0xc3 0x00 0x00 0x00 0x01 0x00 0x00 0xc4 0x00 0x00 0x00 0x01 0x00 0x00 0xc5 0x00 0x00 0x00 0x01 0x00 0x00 0xc6 0x00 0x00 0x00 0x01 0x00 0x00 0xc7 0x00 0x00 0x00 0x01 0x00 0x00 0xc8 0x00 0x00 0x00 0x01 0x00 0x00 0xc9 0x00 0x00 0x00 0x01 0x00 0x00 0xca 0x00 0x00 0x00 0x01 0x00 0x00 0xcb 0x00 0x00 0x00 0x01 0x00 0x00 0xcc 0x00 0x00 0x00 0x01 0x00 0x00 0xcd 0x00 0x00 0x00 0x01 0x00 0x00 0xce 0x00 0x00 0x00 0x01 0x00 0x00 0xcf 0x00 0x00 0x00 0x01 0x00 0x00 0xd0 0x00 0x00 0x00 0x01 0x00 0x00 0xd1 0x00 0x00 0x00 0x01 0x00 0x00 0xd2 0x00 0x00 0x00 0x01 0x00 0x00 0xd3 0x00 0x00 0x00 0x01 0x00 0x00 0xd4 0x00 0x00 0x00 0x01 0x00 0x00 0xd5 0x00 0x00 0x00 0x01 0x00 0x00 0xd6 0x00 0x00 0x00 0x01 0x00 0x00 0xd7 0x00 0x00 0x00 0x01 0x00 0x00 0xd8 0x00 0x00 0x00 0x01 0x00 0x00 0xd9 0x00 0x00 0x00 0x01 0x00 0x00 0xda 0x00 0x00 0x00 0x01 0x00 0x00 0xdb 0x00 0x00 0x00 0x01 0x00 0x00 0xdc 0x00 0x00 0x00 0x01 0x00 0x00 0xdd 0x00 0x00 0x00 0x01 0x00 0x00>;
		};
	};

	fragment@46 {
		target = <0xffffffff>;

		__overlay__ {
			interrupt-parent = <0xffffffff>;
			interrupts = <0x00 0x02>;
			status = "okay";
		};
	};

	fragment@47 {
		target = <0xffffffff>;

		__overlay__ {
			interrupt-parent = <0xffffffff>;
			interrupts = <0x04 0x08>;
			status = "okay";
		};
	};

	fragment@48 {
		target = <0xffffffff>;

		__overlay__ {
			interrupt-parent = <0xffffffff>;
			interrupts = <0x05 0x02>;
			status = "okay";
		};
	};

	fragment@49 {
		target = <0xffffffff>;

		__overlay__ {
			interrupt-parent = <0xffffffff>;
			interrupts = <0x06 0x08>;
			status = "okay";
		};
	};

	fragment@50 {
		target = <0xffffffff>;

		__overlay__ {
			interrupt-parent = <0xffffffff>;
			interrupts = <0x08 0x02>;
			status = "okay";
		};
	};

	fragment@51 {
		target = <0xffffffff>;

		__overlay__ {
			interrupt-parent = <0xffffffff>;
			interrupts = <0x09 0x02>;
			status = "okay";
		};
	};

	fragment@52 {
		target = <0xffffffff>;

		__overlay__ {
			interrupt-parent = <0xffffffff>;
			interrupts = <0x53 0x01>;
			status = "okay";
		};
	};

	fragment@53 {
		target = <0xffffffff>;

		__overlay__ {
			interrupt-parent = <0xffffffff>;
			interrupts = <0x5c 0x04>;
			deb-gpios = <0xffffffff 0x5c 0x00>;
			debounce = <0x00>;
			status = "okay";
		};
	};

	fragment@54 {
		target = <0xffffffff>;

		__overlay__ {
			compatible = "mediatek,md1_sim1_hot_plug_eint-eint";
			interrupts = <0x00 0x08>;
			debounce = <0x00 0x2710>;
			dedicated = <0x00 0x00>;
			src_pin = <0x00 0x01>;
			sockettype = <0x00 0x00>;
			status = "okay";
		};
	};

	fragment@55 {
		target = <0xffffffff>;

		__overlay__ {
			compatible = "mediatek,md1_sim2_hot_plug_eint-eint";
			interrupts = <0x01 0x08>;
			debounce = <0x01 0x2710>;
			dedicated = <0x01 0x00>;
			src_pin = <0x01 0x02>;
			sockettype = <0x01 0x00>;
			status = "okay";
		};
	};

	fragment@56 {
		target = <0xffffffff>;

		__overlay__ {
			mediatek,key-debounce = <0x400>;
			mediatek,sw-pwrkey = <0x74>;
			mediatek,hw-pwrkey = <0x08>;
			mediatek,sw-rstkey = <0x73>;
			mediatek,hw-rstkey = <0x11>;
			mediatek,use-extend-type = <0x00>;
			mediatek,hw-map-num = <0x48>;
			mediatek,hw-init-map = <0x72 0x00 0x00 0x00 0x00 0x00 0x00 0x00 0x00 0x00 0x00 0x00 0x00 0x00 0x00 0x00 0x00 0x00 0x00 0x00 0x00 0x00 0x00 0x00 0x00 0x00 0x00 0x00 0x00 0x00 0x00 0x00 0x00 0x00 0x00 0x00 0x00 0x00 0x00 0x00 0x00 0x00 0x00 0x00 0x00 0x00 0x00 0x00 0x00 0x00 0x00 0x00 0x00 0x00 0x00 0x00 0x00 0x00 0x00 0x00 0x00 0x00 0x00 0x00 0x00 0x00 0x00 0x00 0x00 0x00 0x00 0x00>;
			mediatek,pwrkey-eint-gpio = <0x00>;
			mediatek,pwkey-gpio-din = <0x00>;
			mediatek,hw-dl-key0 = <0x11>;
			mediatek,hw-dl-key1 = <0x00>;
			mediatek,hw-dl-key2 = <0x08>;
			mediatek,hw-recovery-key = <0x11>;
			mediatek,hw-factory-key = <0x00>;
			status = "okay";
		};
	};

	__symbols__ {
		camera_pins_cam0_rst_0 = "/fragment@0/__overlay__/cam0@0";
		camera_pins_cam0_rst_1 = "/fragment@0/__overlay__/cam0@1";
		camera_pins_cam1_rst_0 = "/fragment@0/__overlay__/cam1@0";
		camera_pins_cam1_rst_1 = "/fragment@0/__overlay__/cam1@1";
		camera_pins_cam2_rst_0 = "/fragment@0/__overlay__/cam2@0";
		camera_pins_cam2_rst_1 = "/fragment@0/__overlay__/cam2@1";
		camera_pins_cam3_rst_0 = "/fragment@0/__overlay__/cam3@0";
		camera_pins_cam3_rst_1 = "/fragment@0/__overlay__/cam3@1";
		camera_pins_cam0_vcamio_0 = "/fragment@0/__overlay__/cam0@2";
		camera_pins_cam0_vcamio_1 = "/fragment@0/__overlay__/cam0@3";
		camera_pins_cam1_vcamio_0 = "/fragment@0/__overlay__/cam1@2";
		camera_pins_cam1_vcamio_1 = "/fragment@0/__overlay__/cam1@3";
		camera_pins_cam2_vcamio_0 = "/fragment@0/__overlay__/cam2@2";
		camera_pins_cam2_vcamio_1 = "/fragment@0/__overlay__/cam2@3";
		camera_pins_cam3_vcamio_0 = "/fragment@0/__overlay__/cam3@2";
		camera_pins_cam3_vcamio_1 = "/fragment@0/__overlay__/cam3@3";
		camera_pins_cam0_mclk_off = "/fragment@0/__overlay__/camera_pins_cam0_mclk_off";
		camera_pins_cam0_mclk_2ma = "/fragment@0/__overlay__/camera_pins_cam0_mclk_2ma";
		camera_pins_cam0_mclk_4ma = "/fragment@0/__overlay__/camera_pins_cam0_mclk_4ma";
		camera_pins_cam0_mclk_6ma = "/fragment@0/__overlay__/camera_pins_cam0_mclk_6ma";
		camera_pins_cam0_mclk_8ma = "/fragment@0/__overlay__/camera_pins_cam0_mclk_8ma";
		camera_pins_cam1_mclk_off = "/fragment@0/__overlay__/camera_pins_cam1_mclk_off";
		camera_pins_cam1_mclk_2ma = "/fragment@0/__overlay__/camera_pins_cam1_mclk_2ma";
		camera_pins_cam1_mclk_4ma = "/fragment@0/__overlay__/camera_pins_cam1_mclk_4ma";
		camera_pins_cam1_mclk_6ma = "/fragment@0/__overlay__/camera_pins_cam1_mclk_6ma";
		camera_pins_cam1_mclk_8ma = "/fragment@0/__overlay__/camera_pins_cam1_mclk_8ma";
		camera_pins_cam2_mclk_off = "/fragment@0/__overlay__/camera_pins_cam2_mclk_off";
		camera_pins_cam2_mclk_2ma = "/fragment@0/__overlay__/camera_pins_cam2_mclk_2ma";
		camera_pins_cam2_mclk_4ma = "/fragment@0/__overlay__/camera_pins_cam2_mclk_4ma";
		camera_pins_cam2_mclk_6ma = "/fragment@0/__overlay__/camera_pins_cam2_mclk_6ma";
		camera_pins_cam2_mclk_8ma = "/fragment@0/__overlay__/camera_pins_cam2_mclk_8ma";
		camera_pins_cam3_mclk_off = "/fragment@0/__overlay__/camera_pins_cam3_mclk_off";
		camera_pins_cam3_mclk_2ma = "/fragment@0/__overlay__/camera_pins_cam3_mclk_2ma";
		camera_pins_cam3_mclk_4ma = "/fragment@0/__overlay__/camera_pins_cam3_mclk_4ma";
		camera_pins_cam3_mclk_6ma = "/fragment@0/__overlay__/camera_pins_cam3_mclk_6ma";
		camera_pins_cam3_mclk_8ma = "/fragment@0/__overlay__/camera_pins_cam3_mclk_8ma";
		camera_pins_default = "/fragment@0/__overlay__/camdefault";
		mtk_camera_eeprom3 = "/fragment@3/__overlay__/camera_eeprom3@51";
		camera_sub_two_mtk = "/fragment@3/__overlay__/camera_sub_two@10";
		mtk_camera_eeprom1 = "/fragment@4/__overlay__/camera_eeprom1@51";
		camera_sub_mtk = "/fragment@4/__overlay__/camera_sub@1a";
		mtk_camera_eeprom0 = "/fragment@5/__overlay__/camera_eeprom0@50";
		camera_main_mtk = "/fragment@5/__overlay__/camera_main@1a";
		camera_main_af_mtk = "/fragment@5/__overlay__/camera_main_af@18";
		mtk_camera_eeprom2 = "/fragment@6/__overlay__/camera_eeprom2@51";
		camera_main_two_mtk = "/fragment@6/__overlay__/camera_main_two@10";
		smart_ldo = "/fragment@7/__overlay__/smart_ldo@28";
		flashlight_pins_default = "/fragment@9/__overlay__/flashlightdefault";
		flashlight_pins_en_output1 = "/fragment@9/__overlay__/flashlightenoutput1";
		flashlight_pins_en_output0 = "/fragment@9/__overlay__/flashlightenoutput0";
		flashlight_pins_sel_output1 = "/fragment@9/__overlay__/flashlightseloutput1";
		flashlight_pins_sel_output0 = "/fragment@9/__overlay__/flashlightseloutput0";
		sia81xx_L = "/fragment@10/__overlay__/sia81xx@L";
		sia81xx_i2c_L = "/fragment@12/__overlay__/sia81xx_i2c@L";
		mtee = "/fragment@16/__overlay__/MTEE";
		svp = "/fragment@16/__overlay__/SecureVideoPath";
		mtkfb_pins_lcm_led_en1 = "/fragment@17/__overlay__/lcm_led_en1_gpio";
		mtkfb_pins_lcm_led_en0 = "/fragment@17/__overlay__/lcm_led_en0_gpio";
		mtkfb_pins_lcm_rst_out1_gpio = "/fragment@17/__overlay__/lcm_rst_out1_gpio";
		mtkfb_pins_lcm_rst_out0_gpio = "/fragment@17/__overlay__/lcm_rst_out0_gpio";
		mtkfb_pins_lcm_dsi_te = "/fragment@17/__overlay__/lcm_dsi_te";
		panel_in1 = "/fragment@20/__overlay__/panel1@0/port/endpoint";
		panel_in2 = "/fragment@20/__overlay__/panel2@0/port/endpoint";
		dsi_out = "/fragment@20/__overlay__/ports/port/endpoint";
		gps_pins_default = "/fragment@21/__overlay__/gps_default";
		gps_l1_lna_pins_ol = "/fragment@21/__overlay__/gps_l1_lna@0";
		gps_l1_lna_pins_dsp_ctrl = "/fragment@21/__overlay__/gps_l1_lna@1";
		gps_l1_lna_pins_oh = "/fragment@21/__overlay__/gps_l1_lna@2";
		gps_l5_lna_pins_ol = "/fragment@21/__overlay__/gps_l5_lna@0";
		gps_l5_lna_pins_dsp_ctrl = "/fragment@21/__overlay__/gps_l5_lna@1";
		gps_l5_lna_pins_oh = "/fragment@21/__overlay__/gps_l5_lna@2";
		lm3643 = "/fragment@24/__overlay__/lm3643@63";
		fl_core_0 = "/fragment@24/__overlay__/lm3643@63/flash@0/port@0/endpoint";
		fl_core_1 = "/fragment@24/__overlay__/lm3643@63/flash@1/port@1/endpoint";
		lm3643_pins_default = "/fragment@25/__overlay__/default";
		lm3643_pins_hwen_high = "/fragment@25/__overlay__/hwen_high";
		lm3643_pins_hwen_low = "/fragment@25/__overlay__/hwen_low";
		flashlight_0 = "/fragment@26/__overlay__/port@0/endpoint";
		flashlight_1 = "/fragment@26/__overlay__/port@1/endpoint";
		spk = "/fragment@28/__overlay__/speaker_amp@5c";
		fingerprint_default = "/fragment@43/__overlay__/state_default";
		fingerprint_reset_high = "/fragment@43/__overlay__/state_reset_high";
		fingerprint_reset_low = "/fragment@43/__overlay__/state_reset_low";
		fingerprint_spi_mode = "/fragment@43/__overlay__/spi_mode";
		fingerprint_avdd_high = "/fragment@43/__overlay__/state_avdd_high";
		fingerprint_avdd_low = "/fragment@43/__overlay__/state_avdd_low";
	};

	__fixups__ {
		pio = "/fragment@0:target:0\0/fragment@9:target:0\0/fragment@17:target:0\0/fragment@20/__overlay__/panel1@0:pm-enable-gpios:0\0/fragment@20/__overlay__/panel1@0:reset-gpios:0\0/fragment@20/__overlay__/panel1@0:bias-gpios:0\0/fragment@20/__overlay__/panel1@0:bias-gpios:12\0/fragment@20/__overlay__/panel2@0:pm-enable-gpios:0\0/fragment@20/__overlay__/panel2@0:reset-gpios:0\0/fragment@20/__overlay__/panel2@0:bias-gpios:0\0/fragment@20/__overlay__/panel2@0:bias-gpios:12\0/fragment@21:target:0\0/fragment@23/__overlay__/focaltech@0:interrupt-parent:0\0/fragment@23/__overlay__/focaltech@0:focaltech,reset-gpio:0\0/fragment@23/__overlay__/focaltech@0:focaltech,irq-gpio:0\0/fragment@23/__overlay__/novatek@0:novatek,reset-gpio:0\0/fragment@23/__overlay__/novatek@0:novatek,irq-gpio:0\0/fragment@25:target:0\0/fragment@27/__overlay__/nxp@28:nq-irq:0\0/fragment@27/__overlay__/nxp@28:interrupt-parent:0\0/fragment@27/__overlay__/nxp@28:nq-ven:0\0/fragment@27/__overlay__/nxp@28:nq-firm:0\0/fragment@27/__overlay__/nxp@28:nq-clkreq:0\0/fragment@28/__overlay__/lm3697@36:enable-gpios:0\0/fragment@30/__overlay__/wusb3801@60:interrupt-parent:0\0/fragment@30/__overlay__/wusb3801@60:wusb3801,irq-gpio:0\0/fragment@30/__overlay__/fusb303@21:interrupt-parent:0\0/fragment@30/__overlay__/fusb303@21:fusb303,int-gpio:0\0/fragment@30/__overlay__/type_c_port0:mt6370pd,intr_gpio:0\0/fragment@32/__overlay__:cd-gpios:0\0/fragment@40/__overlay__:swtp-gpio:0\0/fragment@42/__overlay__:fpc,gpio_irq:0\0/fragment@43:target:0\0/fragment@44/__overlay__:GPIO_SIM1_HOT_PLUG:0\0/fragment@44/__overlay__:GPIO_SIM2_HOT_PLUG:0\0/fragment@44/__overlay__:GPIO_SIM1_SCLK:0\0/fragment@44/__overlay__:GPIO_SIM1_SRST:0\0/fragment@44/__overlay__:GPIO_SIM1_SIO:0\0/fragment@44/__overlay__:GPIO_SIM2_SCLK:0\0/fragment@44/__overlay__:GPIO_SIM2_SRST:0\0/fragment@44/__overlay__:GPIO_SIM2_SIO:0\0/fragment@44/__overlay__:GPIO_FDD_BAND_SUPPORT_DETECT_2ND_PIN:0\0/fragment@44/__overlay__:GPIO_FDD_BAND_SUPPORT_DETECT_1ST_PIN:0\0/fragment@44/__overlay__:GPIO_FDD_BAND_SUPPORT_DETECT_3RD_PIN:0\0/fragment@46/__overlay__:interrupt-parent:0\0/fragment@47/__overlay__:interrupt-parent:0\0/fragment@48/__overlay__:interrupt-parent:0\0/fragment@49/__overlay__:interrupt-parent:0\0/fragment@50/__overlay__:interrupt-parent:0\0/fragment@51/__overlay__:interrupt-parent:0\0/fragment@52/__overlay__:interrupt-parent:0\0/fragment@53/__overlay__:interrupt-parent:0\0/fragment@53/__overlay__:deb-gpios:0";
		kd_camera_hw1 = "/fragment@1:target:0";
		camera_af_hw_node = "/fragment@2:target:0";
		mt6358_vio28_reg = "/fragment@2/__overlay__:camaf_m1_pmic-supply:0";
		i2c2 = "/fragment@3:target:0";
		i2c4 = "/fragment@4:target:0";
		i2c8 = "/fragment@5:target:0";
		i2c9 = "/fragment@6:target:0";
		i2c7 = "/fragment@7:target:0\0/fragment@30:target:0";
		flashlights_led191 = "/fragment@8:target:0";
		odm = "/fragment@10:target:0";
		sound = "/fragment@11:target:0\0/fragment@31:target:0";
		i2c6 = "/fragment@12:target:0\0/fragment@24:target:0\0/fragment@28:target:0";
		chosen = "/fragment@13:target:0";
		irtx_pwm = "/fragment@14:target:0";
		mtk_leds = "/fragment@15:target:0";
		mtee_svp = "/fragment@16:target:0";
		mtkfb = "/fragment@18:target:0";
		dispsys_config = "/fragment@19:target:0";
		dsi0 = "/fragment@20:target:0";
		gps = "/fragment@22:target:0";
		spi0 = "/fragment@23:target:0\0/fragment@29:target:0";
		mtk_composite_v4l2_1 = "/fragment@26:target:0";
		i2c3 = "/fragment@27:target:0";
		mmc1 = "/fragment@32:target:0";
		utos = "/fragment@33:target:0";
		extcon_usb = "/fragment@34:target:0";
		u2port0 = "/fragment@35:target:0";
		lk_charger = "/fragment@36:target:0";
		charger = "/fragment@37:target:0";
		bq2589x = "/fragment@37/__overlay__:charger:0\0/fragment@39/__overlay__:charger:0";
		mt6375 = "/fragment@38:target:0";
		mtk_gauge = "/fragment@39:target:0";
		swtp = "/fragment@40:target:0\0/fragment@53:target:0";
		spi3 = "/fragment@41:target:0";
		goodix_fp = "/fragment@42:target:0\0/fragment@46:target:0";
		gpio_usage_mapping = "/fragment@44:target:0";
		gpio = "/fragment@45:target:0";
		subpmic_pmu_eint = "/fragment@47:target:0";
		rt5133_eint = "/fragment@48:target:0";
		smart_pa = "/fragment@49:target:0";
		esd_flag = "/fragment@50:target:0";
		touch = "/fragment@51:target:0";
		dsi_te = "/fragment@52:target:0";
		md1_sim1_hot_plug_eint = "/fragment@54:target:0";
		md1_sim2_hot_plug_eint = "/fragment@55:target:0";
		keypad = "/fragment@56:target:0";
	};

	__local_fixups__ {

		fragment@1 {

			__overlay__ {
				pinctrl-0 = <0x00>;
				pinctrl-1 = <0x00>;
				pinctrl-2 = <0x00>;
				pinctrl-3 = <0x00>;
				pinctrl-4 = <0x00>;
				pinctrl-5 = <0x00>;
				pinctrl-6 = <0x00>;
				pinctrl-7 = <0x00>;
				pinctrl-8 = <0x00>;
				pinctrl-9 = <0x00>;
				pinctrl-10 = <0x00>;
				pinctrl-11 = <0x00>;
				pinctrl-12 = <0x00>;
				pinctrl-13 = <0x00>;
				pinctrl-14 = <0x00>;
				pinctrl-15 = <0x00>;
				pinctrl-16 = <0x00>;
				pinctrl-17 = <0x00>;
				pinctrl-18 = <0x00>;
				pinctrl-19 = <0x00>;
				pinctrl-20 = <0x00>;
				pinctrl-21 = <0x00>;
				pinctrl-22 = <0x00>;
				pinctrl-23 = <0x00>;
				pinctrl-24 = <0x00>;
				pinctrl-25 = <0x00>;
				pinctrl-26 = <0x00>;
				pinctrl-27 = <0x00>;
				pinctrl-28 = <0x00>;
				pinctrl-29 = <0x00>;
				pinctrl-30 = <0x00>;
				pinctrl-31 = <0x00>;
				pinctrl-32 = <0x00>;
				pinctrl-33 = <0x00>;
				pinctrl-34 = <0x00>;
				pinctrl-35 = <0x00>;
				pinctrl-36 = <0x00>;
			};
		};

		fragment@8 {

			__overlay__ {
				pinctrl-0 = <0x00>;
				pinctrl-1 = <0x00>;
				pinctrl-2 = <0x00>;
				pinctrl-3 = <0x00>;
				pinctrl-4 = <0x00>;
			};
		};

		fragment@11 {

			__overlay__ {
				si,sia81xx-aux-devs = <0x00>;
			};
		};

		fragment@12 {

			__overlay__ {

				sia81xx_i2c@L {
					si,sia81xx-dev = <0x00>;
				};
			};
		};

		fragment@18 {

			__overlay__ {
				pinctrl-0 = <0x00>;
				pinctrl-1 = <0x00>;
				pinctrl-2 = <0x00>;
				pinctrl-3 = <0x00>;
				pinctrl-4 = <0x00>;
			};
		};

		fragment@19 {

			__overlay__ {
				pinctrl-0 = <0x00>;
				pinctrl-1 = <0x00>;
				pinctrl-2 = <0x00>;
			};
		};

		fragment@20 {

			__overlay__ {

				panel1@0 {

					port {

						endpoint {
							remote-endpoint = <0x00>;
						};
					};
				};

				panel2@0 {

					port {

						endpoint {
							remote-endpoint = <0x00>;
						};
					};
				};

				ports {

					port {

						endpoint {
							remote-endpoint = <0x00>;
						};
					};
				};
			};
		};

		fragment@22 {

			__overlay__ {
				pinctrl-0 = <0x00>;
				pinctrl-1 = <0x00>;
				pinctrl-2 = <0x00>;
				pinctrl-3 = <0x00>;
				pinctrl-4 = <0x00>;
				pinctrl-5 = <0x00>;
				pinctrl-6 = <0x00>;
			};
		};

		fragment@24 {

			__overlay__ {

				lm3643@63 {
					pinctrl-0 = <0x00>;
					pinctrl-1 = <0x00>;
					pinctrl-2 = <0x00>;

					flash@0 {

						port@0 {

							endpoint {
								remote-endpoint = <0x00>;
							};
						};
					};

					flash@1 {

						port@1 {

							endpoint {
								remote-endpoint = <0x00>;
							};
						};
					};
				};
			};
		};

		fragment@26 {

			__overlay__ {

				port@0 {

					endpoint {
						remote-endpoint = <0x00>;
					};
				};

				port@1 {

					endpoint {
						remote-endpoint = <0x00>;
					};
				};
			};
		};

		fragment@31 {

			__overlay__ {

				mediatek,speaker-codec {
					sound-dai = <0x00>;
				};
			};
		};

		fragment@42 {

			__overlay__ {
				pinctrl-0 = <0x00>;
				pinctrl-1 = <0x00>;
				pinctrl-2 = <0x00>;
				pinctrl-3 = <0x00>;
				pinctrl-4 = <0x00>;
				pinctrl-5 = <0x00>;
			};
		};
	};
};
